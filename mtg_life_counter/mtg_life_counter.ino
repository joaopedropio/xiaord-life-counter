// MTG Life Counter - XIAO nRF52840 + Seeed Round Display for XIAO
//
// Controls:
//   - Drag your finger around the outer rim: clockwise = +1, counter-clockwise = -1
//   - Tap right of the number: +1   | hold: +10 every 0.6 s
//   - Tap left of the number:  -1   | hold: -10 every 0.6 s
//   - Tap the very center: menu (Reset / 20 / 40 / Dice / Light / Theme / Back), drawn as icons
//   - Dice: pick d4..d20, it rolls and shows the result until you tap the screen
//   - Theme: mana colors (W/U/B/R/G) for the rim, the dot and the buttons
//   - Everything is saved to internal flash and restored on the next boot.
//
// Setup (Arduino IDE / arduino-cli):
//   1. Board package: "Seeed nRF52 Boards" (NOT the mbed-enabled one)
//   2. Libraries: Seeed_GFX and Seeed_Arduino_FS (both from GitHub: Seeed-Studio)
//   3. Keep driver.h in the same folder as this sketch
//   4. Round Display slide switch ON, small DIP switch ON (backlight + battery read)
//
// Rendering: everything is drawn into a 240x240 framebuffer in RAM (TFT_eSprite,
// 115 KB) and only the changed rectangle is sent to the GC9A01 with one EasyDMA
// SPI transfer per row at 32 MHz. Seeed_GFX's own nRF52840 path sends every byte
// as a separate SPI transaction, which is far too slow for smooth updates.

#include <Wire.h>
#include <SPI.h>
#include <bluefruit.h>
#include <math.h>
#include "driver.h"
#include <TFT_eSPI.h>
#include "bigfont.h"
// life-number fonts, generated by tools/build_fonts.sh (XL: up to 2 characters,
// L: up to 4). Order = FONTS[] below = the saved setting.
#include "fonts/noto_xl.h"
#include "fonts/noto_l.h"
#include "fonts/cinzel_xl.h"
#include "fonts/cinzel_l.h"
#include "fonts/bebas_xl.h"
#include "fonts/bebas_l.h"
#include "fonts/orbitron_xl.h"
#include "fonts/orbitron_l.h"
#include "fonts/bungee_xl.h"
#include "fonts/bungee_l.h"
#include "fonts/blackops_xl.h"
#include "fonts/blackops_l.h"
#include "fonts/pixel_xl.h"
#include "fonts/pixel_l.h"
#include "fonts/marker_xl.h"
#include "fonts/marker_l.h"
#include "fonts/righteous_xl.h"
#include "fonts/righteous_l.h"
#include "fonts/bangers_xl.h"
#include "fonts/bangers_l.h"
#include "fonts/creepster_xl.h"
#include "fonts/creepster_l.h"
#include "fonts/griffy_xl.h"
#include "fonts/griffy_l.h"

// ---------- Tuning ----------
const int   STEP_DEGREES   = 15;    // degrees of rim travel per 1 life (24 per full lap)
const int   RIM_INNER_R    = 80;    // touches farther than this from center count as rim
const int   CENTER_R       = 30;    // touches closer than this open the menu
const unsigned long HOLD_MS = 600;  // hold left/right this long for -10/+10 (repeats)
const unsigned long MENU_TAP_MAX_MS = 600; // a center touch longer than this does nothing
const int   MAX_JUMP_DEG   = 60;    // bigger angle jumps between two reads are ignored (glitch / lift-off)
const unsigned long FRAME_MS   = 16; // redraw at most ~60 times/s; touch is read every loop
const unsigned long RELEASE_MS = 80; // touch ends after this long with no valid read
const unsigned long SAVE_DELAY_MS = 3000; // save to flash this long after the last change
const bool  INVERT_DIRECTION = false; // set true if clockwise subtracts on your unit
const bool  SPI_32MHZ = true;         // set false if the screen shows glitches (falls back to 16 MHz)
#define FW_VERSION "0.2.0"
#define DEBUG 0                       // 1 = serial log at 115200 + test commands (development only)

#if DEBUG
  #define DBG(...) do { Serial.printf(__VA_ARGS__); Serial.println(); } while (0)
#else
  #define DBG(...) do {} while (0)
#endif

// ---------- Hardware ----------
#define TOUCH_INT   D7
#define TOUCH_ADDR  0x2E
#define BACKLIGHT   D6
#define BATTERY_PIN A0

const uint16_t GREY = 0x7BEF;
const uint16_t BTN_FILL = 0x18E3;       // very dark grey (button fill)
const int W = 240, H = 240;
const int CX = 120, CY = 120;

TFT_eSPI    tft = TFT_eSPI();
TFT_eSprite fb  = TFT_eSprite(&tft);   // full-screen framebuffer
uint16_t   *fbPix = nullptr;           // its pixels, already byte-swapped for SPI

// ---------- State ----------
int startingLife = 20;
int life = 20;
int brightness = 100;                   // backlight %, BRIGHT_MIN..100
const int BRIGHT_MIN = 1;
const int BRIGHT_STEP_DEG = 5;          // rim travel per 1% brightness (72% per lap)
bool brightDirty = false;

// mana color themes: rim ring, slider dot and button borders
struct Theme { char letter; uint16_t ring, accent; };
const Theme THEMES[] = {
  { '-', 0x39E7, TFT_ORANGE },          // default: dark grey ring, orange dot
  { 'W', 0x83EB, 0xFFB9 },              // white: warm cream
  { 'U', 0x11F0, 0x3CBF },              // blue
  { 'B', 0x594F, 0xAADB },              // black: violet
  { 'R', 0x78A1, 0xFA26 },              // red
  { 'G', 0x1325, 0x3E8B },              // green
};
const int THEME_COUNT = sizeof(THEMES) / sizeof(THEMES[0]);
int theme = 0;                          // 0..THEME_COUNT-1 built in, then the custom slots

// ---- custom themes, sent from the web page over BLE ----
// Each slot holds one record: a 64-byte header, a 256-color RGB565 palette and the
// 240x240 background as palette indices. The background already has the ring and
// any decoration; the firmware draws the number, "+3", battery and dot on top and
// repaints from the image (read straight from flash) to erase them.
struct CustomTheme {
  uint32_t magic;                       // CT_MAGIC ("MTGT")
  uint32_t len;                         // whole record, header included (CT_RECORD)
  uint32_t crc;                         // CRC-32 of bytes [12, len)
  char     name[20];
  uint16_t num, acc, acc2, muted, fill, plus, minus, warn[3];   // RGB565
  uint8_t  fx;                          // FX_NONE / FX_SHADOW / FX_GRAD (on the life number)
  int8_t   fxDx, fxDy;                  // shadow offset (clamped to +-3)
  uint8_t  font;                        // 1..FONT_COUNT: font (index + 1) to switch to when chosen; 0 = keep
  uint16_t fxColor[3];                  // shadow color, or gradient top / middle / bottom
  uint16_t reserved2;
};
static_assert(sizeof(CustomTheme) == 64, "CustomTheme header must be 64 bytes");
enum { FX_NONE, FX_SHADOW, FX_GRAD };
const uint32_t CT_MAGIC = 0x5447544D;   // bytes 'M','T','G','T'
const int      CT_SLOTS = 2;
const uint32_t CT_SLOT_BYTES = 0xF000;  // 15 pages
// Right below the InternalFS area (0xED000). Serial DFU erases only the pages the new
// firmware needs, so this survives uploads while the sketch ends below CT_BASE.
const uint32_t CT_BASE = 0xED000 - CT_SLOTS * CT_SLOT_BYTES;   // 0xCF000
const uint32_t CT_RECORD = 64 + 512 + 240 * 240;               // 58176
bool     ctEnabled = true;              // false if the firmware grew into the slots
bool     ctValid[CT_SLOTS] = { false, false };
uint16_t ctPal[256];                    // active custom palette, byte-swapped like fbPix

// macros, not functions: the Arduino builder puts prototypes before the first function
#define ctHeader(slot) ((const CustomTheme *)(CT_BASE + (slot) * CT_SLOT_BYTES))
#define ctPixels(slot) ((const uint8_t *)ctHeader(slot) + 64 + 512)

struct FontChoice { const BigFont *xl, *l; };
const FontChoice FONTS[] = {
  { &F_NOTO_XL, &F_NOTO_L },            // 0 Noto Sans Bold (default)
  { &F_CINZEL_XL, &F_CINZEL_L },        // 1 Cinzel
  { &F_BEBAS_XL, &F_BEBAS_L },          // 2 Bebas Neue
  { &F_ORBITRON_XL, &F_ORBITRON_L },    // 3 Orbitron
  { &F_BUNGEE_XL, &F_BUNGEE_L },        // 4 Bungee
  { &F_BLACKOPS_XL, &F_BLACKOPS_L },    // 5 Black Ops One
  { &F_PIXEL_XL, &F_PIXEL_L },          // 6 Press Start 2P
  { &F_MARKER_XL, &F_MARKER_L },        // 7 Permanent Marker
  { &F_RIGHTEOUS_XL, &F_RIGHTEOUS_L },  // 8 Righteous
  { &F_BANGERS_XL, &F_BANGERS_L },      // 9 Bangers
  { &F_CREEPSTER_XL, &F_CREEPSTER_L },  // 10 Creepster
  { &F_GRIFFY_XL, &F_GRIFFY_L },        // 11 Griffy
};
const int FONT_COUNT = sizeof(FONTS) / sizeof(FONTS[0]);
int fontIdx = 0;
int previewNum = 20;                    // number shown on the font screen (not the life total)
bool fontDirty = false;

// screen auto-off: backlight off + panel asleep after this long without a touch
const int SLEEP_SECS[] = { 0, 5, 10, 15, 30, 60, 120, 300 };     // 0 = never
const char *SLEEP_LABELS[] = { "nunca", "5 s", "10 s", "15 s", "30 s", "1 min", "2 min", "5 min" };
const int SLEEP_OPTIONS = sizeof(SLEEP_SECS) / sizeof(SLEEP_SECS[0]);
int  sleepIdx = 4;                      // default 30 s
const int MENU_MIN_SLEEP_S = 15;        // floor for the auto-off outside the life screen
bool asleep = false;
unsigned long lastActivityMs = 0;

// ---- screen layouts (Menu > Tema > Layout) ----
// life screen A..F and main menu 1..6, from tools/mockups/layouts.html
enum { L_CLASSIC, L_LIFEBAR, L_TICKS, L_HINTS, L_HISTORY, L_HALO, LIFE_LAYOUTS };
const char *LIFE_LAYOUT_NAMES[LIFE_LAYOUTS] = { "Atual", "Anel de vida", "Marcas", "Dicas", "Recentes", "Halo" };
enum { ML_GRID, ML_RADIAL, ML_SLICES, ML_CAROUSEL, ML_CIRCLES, ML_LIST, MENU_LAYOUTS };
const char *MENU_LAYOUT_NAMES[MENU_LAYOUTS] = { "Grade", "Radial", "Fatias", "Carrossel", "Redondos", "Lista" };
int  lifeLayout = L_CLASSIC;
int  menuLayout = ML_GRID;
bool menuBg = true;                     // custom theme image behind the main menu
int  menuCur = 7;                       // carousel / list: highlighted item (M_BACK)
bool menuDirty = false;
const int MENU_STEP_DEG = 30;           // rim travel per item in the carousel / list
bool rimMoved = false;                  // the current rim touch changed something
// L_HISTORY: last changes (each one lands 2 s after the last touch), oldest first
const int HIST_N = 3;
int  hist[HIST_N];
int  histCount = 0;
// L_TICKS: finger angle (0 = top, clockwise) the ticks show / should show; -1 = none
float tickShown = -1, tickWant = -1;

// what the current touch started on
enum Zone { Z_NONE, Z_RIM, Z_CENTER, Z_PLUS, Z_MINUS, Z_MENU };
Zone zone = Z_NONE;

// touch tracking
bool  touching = false;
int   touchX = 0, touchY = 0;           // where the current touch started
float lastAngle = 0;
float angleAccum = 0;
unsigned long touchStart = 0;
unsigned long lastTouchReadMs = 0;
unsigned long lastHoldMs = 0;           // last +10/-10 while holding
bool  holdFired = false;

// change indicator ("+3" / "-2")
int  pendingDelta = 0;
unsigned long lastChangeMs = 0;

// what needs redrawing on the next frame
bool lifeDirty = false;
bool deltaDirty = false;
int  wantMarkerX = -1, wantMarkerY = -1;
int  markerX = -1, markerY = -1;

// which screen is showing; everything but S_LIFE handles taps on touch end
enum Screen { S_LIFE, S_MENU, S_DICE_PICK, S_DICE_RESULT, S_BRIGHT, S_THEME, S_FONT, S_LAYOUT, S_BLE };

// Bluetooth is off until "Conectar" (Menu > Tema > Bluetooth): it advertises for BLE_ADV_S,
// a connection with no traffic for BLE_IDLE_S is dropped, and it doesn't come back on by itself.
const unsigned long BLE_ADV_S = 180, BLE_IDLE_S = 120;
bool bleAdvertising = false;
volatile bool bleConnected = false;
volatile bool bleUiDirty = false;       // S_BLE status changed (set from the BLE callbacks)
unsigned long bleOnMs = 0;              // advertising started
volatile unsigned long bleLastMs = 0;   // last traffic on the connection
Screen screen = S_LIFE;

unsigned long lastBatteryMs = 0;

// low-battery mode: on battery at <= LOW_BAT_ON %, the backlight drops to
// LOW_BAT_BRIGHT and the auto-off becomes LOW_BAT_SLEEP_S, without touching the
// saved settings. It ends at >= LOW_BAT_OFF % (the reading recovers a bit once the
// load drops, so a gap avoids flapping) or when USB is plugged in.
const int LOW_BAT_ON = 20, LOW_BAT_OFF = 25;
const int LOW_BAT_BRIGHT = 1;           // % (BRIGHT_MIN)
const int LOW_BAT_SLEEP_S = 5;
bool lowBattery = false;
int  batPct = 100;
#if DEBUG
int  batOverride = -1;                  // serial "bat N": fake N % and ignore USB; -1 = real
#endif

// persistence (struct must be defined before any function: Arduino puts
// auto-generated prototypes above the first function)
struct SavedState {                      // one 16-byte record in the flash log
  uint32_t seq;                          // increases with every save; newest wins
  int16_t  life;
  uint8_t  startingLife;                 // 20 or 40
  uint8_t  brightness;                   // backlight %, 1..100
  uint8_t  sleep5s;                      // auto-off time / 5 s (0 = never)
  uint8_t  font;                         // index in FONTS (0xFF in old records = default)
  uint8_t  layout;                       // life layout | menu layout << 4 | 0x80 = no menu image (0xFF in old records = defaults)
  uint8_t  theme;                        // low nibble = theme (0xFF in old records = default)
  uint32_t check;                        // checksum over the other fields
};
static_assert(sizeof(SavedState) == 16, "SavedState must be 16 bytes (4-byte flash words)");
bool saveDirty = false;
// menu buttons: rectangles used both for drawing and for hit-testing
// icons drawn instead of text on buttons and screen titles
enum Icon : uint8_t { I_NONE, I_RESET, I_DICE, I_SUN, I_PALETTE, I_BACK, I_CHECK, I_MOON, I_INF,
                     I_LEFT, I_RIGHT, I_LAYOUT, I_BT };
struct Btn { int x, y, w, h; const char *label; uint8_t icon; };   // label or icon
unsigned long saveDirtySince = 0;

// ================= Fast display flush =================
// Dirty rectangle (inclusive) accumulated since the last flush.
int dx0 = W, dy0 = H, dx1 = -1, dy1 = -1;

void markDirty(int x, int y, int w, int h) {
  if (w <= 0 || h <= 0) return;
  dx0 = min(dx0, max(x, 0));
  dy0 = min(dy0, max(y, 0));
  dx1 = max(dx1, min(x + w - 1, W - 1));
  dy1 = max(dy1, min(y + h - 1, H - 1));
}

void flush() {
  if (dx1 < dx0 || dy1 < dy0) return;
  int w = dx1 - dx0 + 1;

  tft.startWrite();                                   // CS low + SPI transaction
  SPI.setClockDivider(SPI_32MHZ ? SPI_CLOCK_DIV2 : SPI_CLOCK_DIV4);
  tft.setWindow(dx0, dy0, dx1, dy1);                  // leaves DC in data mode
  if (w == W) {
    // full-width rows are contiguous: one DMA transfer (split in 64 KB chunks by the core)
    SPI.transfer(fbPix + dy0 * W, (void *)nullptr, (size_t)w * (dy1 - dy0 + 1) * 2);
  } else {
    for (int y = dy0; y <= dy1; y++)
      SPI.transfer(fbPix + y * W + dx0, (void *)nullptr, (size_t)w * 2);
  }
  tft.endWrite();

  dx0 = W; dy0 = H; dx1 = -1; dy1 = -1;
}

// ================= Touch =================
// NOTE: the CHSC6X INT line PULSES low once per new report; it does NOT stay low
// while the finger is down. So INT only means "a new report is ready", and the
// end of a touch is detected by RELEASE_MS without any valid report.
bool touchReady() {
  return digitalRead(TOUCH_INT) == LOW;
}

// The core's Wire.requestFrom() busy-waits on the TWIM events with NO timeout, so
// a single lost/stretched transfer from the touch chip froze the whole sketch.
// This reads the touch directly on TWIM0 (the peripheral Wire set up) with a
// timeout, and recovers the bus if it gets stuck.
NRF_TWIM_Type *const TWIM = NRF_TWIM0;
const uint32_t I2C_TIMEOUT_US = 5000;   // a 5-byte read at 100 kHz takes ~0.6 ms
uint32_t i2cErrors = 0, i2cTimeouts = 0;

// Free a stuck bus: clock SCL up to 9 times until the slave releases SDA,
// send a STOP, then let Wire reconfigure the peripheral.
void i2cRecover() {
  TWIM->TASKS_STOP = 1;
  TWIM->ENABLE = TWIM_ENABLE_ENABLE_Disabled << TWIM_ENABLE_ENABLE_Pos;
  // open-drain emulation: OUTPUT LOW = pull down, INPUT_PULLUP = release
  pinMode(PIN_WIRE_SDA, INPUT_PULLUP);
  for (int i = 0; i < 9 && digitalRead(PIN_WIRE_SDA) == LOW; i++) {
    pinMode(PIN_WIRE_SCL, OUTPUT); digitalWrite(PIN_WIRE_SCL, LOW);
    delayMicroseconds(5);
    pinMode(PIN_WIRE_SCL, INPUT_PULLUP);
    delayMicroseconds(5);
  }
  // STOP: SDA low -> high while SCL is high
  pinMode(PIN_WIRE_SDA, OUTPUT); digitalWrite(PIN_WIRE_SDA, LOW);
  delayMicroseconds(5);
  pinMode(PIN_WIRE_SCL, INPUT_PULLUP);
  delayMicroseconds(5);
  pinMode(PIN_WIRE_SDA, INPUT_PULLUP);
  delayMicroseconds(5);
  Wire.begin();
}

// Waits for an event with a timeout. Returns false on timeout.
bool twimWait(volatile uint32_t &event, uint32_t t0) {
  while (!event) {
    if (micros() - t0 > I2C_TIMEOUT_US) return false;
  }
  return true;
}

bool i2cRead(uint8_t addr, uint8_t *dst, uint8_t n) {
  static uint8_t rx[8];                 // EasyDMA buffer must be in RAM
  if (n > sizeof(rx)) return false;

  TWIM->EVENTS_STOPPED = 0;
  TWIM->EVENTS_ERROR = 0;
  TWIM->EVENTS_LASTRX = 0;
  TWIM->ERRORSRC = TWIM->ERRORSRC;      // write-1-to-clear
  TWIM->ADDRESS = addr;
  TWIM->RXD.PTR = (uint32_t)rx;
  TWIM->RXD.MAXCNT = n;
  TWIM->SHORTS = TWIM_SHORTS_LASTRX_STOP_Msk; // send STOP automatically after the last byte
  TWIM->TASKS_RESUME = 1;
  TWIM->TASKS_STARTRX = 1;

  uint32_t t0 = micros();
  bool ok = true;
  while (!TWIM->EVENTS_STOPPED) {
    if (TWIM->EVENTS_ERROR) {           // NACK / overrun: stop and bail out
      TWIM->TASKS_STOP = 1;
      if (!twimWait(TWIM->EVENTS_STOPPED, micros())) { i2cTimeouts++; i2cRecover(); }
      i2cErrors++;
      ok = false;
      break;
    }
    if (micros() - t0 > I2C_TIMEOUT_US) {
      i2cTimeouts++;
      DBG("i2c timeout -> bus recovery");
      i2cRecover();
      ok = false;
      break;
    }
  }
  TWIM->SHORTS = 0;
  TWIM->EVENTS_STOPPED = 0;
  TWIM->EVENTS_ERROR = 0;
  if (!ok || TWIM->RXD.AMOUNT != n) return false;
  memcpy(dst, rx, n);
  return true;
}

bool readTouch(int &x, int &y) {
  uint8_t buf[5];
  if (!i2cRead(TOUCH_ADDR, buf, 5)) return false;
  if (buf[0] != 0x01) return false;
  x = buf[2];
  y = buf[4];
  return true;
}

// ================= Persistence (raw internal flash, append-only log) =================
// Two 4 KB flash pages hold a log of 16-byte records. A save appends one record
// to the active page (4 word writes, well under 1 ms, no erase). Only when that
// page is full is the OTHER page erased (~85 ms) and used next; the full page
// stays intact until then, so a power cut at any moment leaves the last good
// record readable. On boot the valid record with the highest seq wins.
//
// The pages are the last two of the area the linker reserves for InternalFS
// (0xED000-0xF4000, below the bootloader at 0xF4000). Nothing else in this
// sketch uses InternalFS, and firmware uploads never touch that area.
// Writes use sd_flash_* once BLE (the SoftDevice) is on, the NVMC directly before.
const uint32_t PAGE_SIZE = 4096;
const uint32_t STATE_PAGES[2] = { 0xF2000, 0xF3000 };
const int SLOTS_PER_PAGE = PAGE_SIZE / sizeof(SavedState);   // 256

int      activePage = -1;   // page holding the newest record (-1: none yet)
int      nextSlot = 0;      // where the next record goes in activePage
bool     activeAppendable = false;
uint32_t lastSeq = 0;

// Hashes every word before `check`. The seed changed from "MTG1" when the record
// grew from 12 to 16 bytes, so old records never pass as new ones.
uint32_t stateCheck(const SavedState &s) {
  uint32_t h = 0x4D544732;                        // "MTG2"
  const uint32_t *w = (const uint32_t *)&s;
  for (unsigned i = 0; i < sizeof(SavedState) / 4 - 1; i++) h = (h ^ w[i]) * 0x9E3779B1u;
  return h ^ (h >> 15);
}

// position of `secs` in SLEEP_SECS, or -1
int sleepIndexOf(int secs) {
  for (int i = 0; i < SLEEP_OPTIONS; i++) if (SLEEP_SECS[i] == secs) return i;
  return -1;
}

const SavedState *slotPtr(int page, int slot) {
  return (const SavedState *)(STATE_PAGES[page] + slot * sizeof(SavedState));
}

bool slotErased(const SavedState *r) {
  const uint32_t *w = (const uint32_t *)r;
  for (unsigned i = 0; i < sizeof(SavedState) / 4; i++) if (w[i] != 0xFFFFFFFF) return false;
  return true;
}

bool slotValid(const SavedState *r) {
  return r->seq != 0xFFFFFFFF && r->check == stateCheck(*r) &&
         (r->startingLife == 20 || r->startingLife == 40) &&
         r->brightness >= BRIGHT_MIN && r->brightness <= 100 && sleepIndexOf(r->sleep5s * 5) >= 0 &&
         r->life >= -999 && r->life <= 999;
}

void nvmcWait() { while (NRF_NVMC->READY == NVMC_READY_READY_Busy) {} }

// With BLE on, the SoftDevice owns the NVMC: flash ops go through sd_flash_* and run
// asynchronously between radio events. We wait for them by watching the flash
// contents (the SoC event also arrives, but Bluefruit hands it to InternalFS).
bool sdEnabled() {
  uint8_t en = 0;
  sd_softdevice_is_enabled(&en);
  return en;
}

bool pageBlank(uint32_t addr) {
  const uint32_t *w = (const uint32_t *)addr;
  for (uint32_t i = 0; i < PAGE_SIZE / 4; i++) if (w[i] != 0xFFFFFFFF) return false;
  return true;
}

void flashErasePage(uint32_t addr) {
  if (sdEnabled()) {
    while (sd_flash_page_erase(addr / PAGE_SIZE) == NRF_ERROR_BUSY) delay(1);
    unsigned long t0 = millis();
    while (!pageBlank(addr) && millis() - t0 < 500) delay(1);
    return;
  }
  NRF_NVMC->CONFIG = NVMC_CONFIG_WEN_Een << NVMC_CONFIG_WEN_Pos;
  nvmcWait();
  NRF_NVMC->ERASEPAGE = addr;
  nvmcWait();
  NRF_NVMC->CONFIG = NVMC_CONFIG_WEN_Ren << NVMC_CONFIG_WEN_Pos;
  nvmcWait();
}

void flashWriteWords(uint32_t addr, const uint32_t *src, int n) {
  if (sdEnabled()) {
    while (n > 0) {
      int k = min(n, 256);              // 1 KB per op (S140 has trouble with whole pages)
      while (sd_flash_write((uint32_t *)addr, src, k) == NRF_ERROR_BUSY) delay(1);
      unsigned long t0 = millis();
      while (memcmp((const void *)addr, src, k * 4) != 0 && millis() - t0 < 200) delay(1);
      addr += k * 4; src += k; n -= k;
    }
    return;
  }
  NRF_NVMC->CONFIG = NVMC_CONFIG_WEN_Wen << NVMC_CONFIG_WEN_Pos;
  nvmcWait();
  for (int i = 0; i < n; i++) {
    ((volatile uint32_t *)addr)[i] = src[i];
    nvmcWait();
  }
  NRF_NVMC->CONFIG = NVMC_CONFIG_WEN_Ren << NVMC_CONFIG_WEN_Pos;
  nvmcWait();
}

void loadState() {
  const SavedState *best = nullptr;
  for (int p = 0; p < 2; p++) {
    // valid records are written contiguously from slot 0
    int i = 0;
    const SavedState *newest = nullptr;
    while (i < SLOTS_PER_PAGE && slotValid(slotPtr(p, i))) { newest = slotPtr(p, i); i++; }
    if (newest && (!best || newest->seq > best->seq)) {
      best = newest;
      activePage = p;
      nextSlot = i;
      // appendable only if the slot after the last record is still blank
      activeAppendable = (i < SLOTS_PER_PAGE) && slotErased(slotPtr(p, i));
    }
  }
  if (!best) { DBG("no saved state"); return; }
  lastSeq = best->seq;
  life = best->life;
  startingLife = best->startingLife;
  brightness = best->brightness;
  sleepIdx = sleepIndexOf(best->sleep5s * 5);
  int t = best->theme & 0x0F;
  theme = t < THEME_COUNT + CT_SLOTS ? t : 0;  // custom slots are checked in ctInit()
  fontIdx = best->font < FONT_COUNT ? best->font : 0;
  if (best->layout != 0xFF) {
    int l = best->layout & 0x0F, m = (best->layout >> 4) & 0x07;
    lifeLayout = l < LIFE_LAYOUTS ? l : L_CLASSIC;
    menuLayout = m < MENU_LAYOUTS ? m : ML_GRID;
    menuBg = !(best->layout & 0x80);
  }
  DBG("loaded life=%d start=%d (page %d slot %d seq %lu)",
      life, startingLife, activePage, nextSlot - 1, lastSeq);
}

void saveState() {
  saveDirty = false;
  SavedState s = { lastSeq + 1, (int16_t)life, (uint8_t)startingLife, (uint8_t)brightness,
                   (uint8_t)(SLEEP_SECS[sleepIdx] / 5), (uint8_t)fontIdx,
                   (uint8_t)(lifeLayout | menuLayout << 4 | (menuBg ? 0 : 0x80)),
                   (uint8_t)theme, 0 };
  s.check = stateCheck(s);
  unsigned long t0 = micros();

  if (activePage < 0 || !activeAppendable || nextSlot >= SLOTS_PER_PAGE) {
    // move to the other page (or page 0 the first time): erase it, start at slot 0
    activePage = (activePage < 0) ? 0 : 1 - activePage;
    flashErasePage(STATE_PAGES[activePage]);
    nextSlot = 0;
    activeAppendable = true;
  }
  uint32_t addr = (uint32_t)slotPtr(activePage, nextSlot);
  flashWriteWords(addr, (const uint32_t *)&s, sizeof(s) / 4);

  if (!slotValid(slotPtr(activePage, nextSlot))) {   // verify; on failure retry on the other page next time
    DBG("save verify FAILED at 0x%lx", addr);
    activeAppendable = false;
    saveDirty = true;
    saveDirtySince = millis();
    return;
  }
  lastSeq = s.seq;
  nextSlot++;
  DBG("saved life=%d theme=%d font=%d start=%d bright=%d sleep=%ds (page %d slot %d seq %lu) in %lu us",
      life, theme, fontIdx, startingLife, brightness, SLEEP_SECS[sleepIdx], activePage, nextSlot - 1, lastSeq, micros() - t0);
}

void requestSave() {
  saveDirty = true;
  saveDirtySince = millis();
}

// ================= Drawing (into the framebuffer) =================
// ---- anti-aliased big digits (fonts from tools/make_bigfont.py) ----
const BigGlyph *bigGlyph(const BigFont &f, char c) {
  for (int i = 0; i < f.count; i++) if (f.glyphs[i].ch == c) return &f.glyphs[i];
  return nullptr;
}

// ink extent of `s` relative to the pen start
void bigExtent(const BigFont &f, const String &s, int &minX, int &maxX) {
  int pen = 0;
  minX = 10000; maxX = -10000;
  for (unsigned i = 0; i < s.length(); i++) {
    const BigGlyph *g = bigGlyph(f, s[i]);
    if (!g) continue;
    minX = min(minX, pen + g->dx);
    maxX = max(maxX, pen + g->dx + g->w);
    pen += g->adv;
  }
  if (maxX < minX) minX = maxX = 0;
}

int bigWidth(const BigFont &f, const String &s) {
  int a, b;
  bigExtent(f, s, a, b);
  return b - a;
}

// ---- custom theme helpers ----
// The custom theme in use, or null. Only the life screen shows it; the menus stay
// black with the theme's accent colors.
const CustomTheme *activeCustom() {
  return theme >= THEME_COUNT ? ctHeader(theme - THEME_COUNT) : nullptr;
}
const CustomTheme *lifeCustom() { return screen == S_LIFE ? activeCustom() : nullptr; }

uint16_t ringColor()   { const CustomTheme *c = activeCustom(); return c ? c->acc2 : THEMES[theme].ring; }
uint16_t accentColor() { const CustomTheme *c = activeCustom(); return c ? c->acc : THEMES[theme].accent; }

inline uint16_t swap16(uint16_t v) { return (v >> 8) | (v << 8); }

// a custom theme can carry a life-number font (picked on the web page): switch to it
// when the theme is chosen (not at boot: the saved font wins there)
void applyThemeFont() {
  const CustomTheme *c = activeCustom();
  if (c && c->font >= 1 && c->font <= FONT_COUNT) fontIdx = c->font - 1;
}

// call whenever `theme` changes: loads the custom palette
void themeChanged() {
  const CustomTheme *c = activeCustom();
  if (!c) return;
  const uint16_t *pal = (const uint16_t *)((const uint8_t *)c + 64);
  for (int i = 0; i < 256; i++) ctPal[i] = swap16(pal[i]);
}

// The custom image shows on the life screen, and behind the main menu unless turned off.
const CustomTheme *bgCustom() {
  if (screen == S_LIFE || (screen == S_MENU && menuBg)) return activeCustom();
  return nullptr;
}

// ---- life screen background, per layout ----
// The ring / ticks / hints / halo / life bar are part of the background: restoreBg()
// recomputes them pixel by pixel, so erasing the number or the dot never cuts them.
const int RING_LO = 107 * 107 - 107, RING_HI = 110 * 110 + 110;   // r 106.5 .. 110.5
const int THIN_LO = 11751, THIN_HI = 12012;                       // r 108.4 .. 109.6
const int TICK_LO = 100 * 100, TICK_HI = 111 * 111;
const int HALO_N = 452;                 // indexed by r^2 / 64 (corners: 28800 / 64 = 450)
uint16_t haloLut[HALO_N];               // byte-swapped
uint16_t bgRing, bgDim, bgThin, bgHintMinus, bgHintPlus;   // RGB565
float    barShownDeg = 0;               // L_LIFEBAR: lit part of the ring, degrees from the top
uint16_t barShownCol = 0;
uint16_t tickCol[24];
bool     tickLit[24];

// 0 = top, clockwise, 0..360
float angTop(int dx, int dy) {
  float a = atan2f((float)dx, (float)-dy) * (180.0f / PI);
  return a < 0 ? a + 360.0f : a;
}

float barDeg() {
  if (startingLife <= 0) return 0;
  return constrain((float)life / startingLife, 0.0f, 1.0f) * 360.0f;
}

void prepTicks() {
  uint16_t ring = ringColor(), acc = accentColor();
  for (int k = 0; k < 24; k++) {
    float d = 999;
    if (tickShown >= 0) { d = fabsf(k * 15.0f - tickShown); if (d > 180) d = 360 - d; }
    tickLit[k] = d <= 30;
    tickCol[k] = tickLit[k] ? fb.alphaBlend((uint8_t)(255 * (1 - d / 45)), acc, ring) : ring;
  }
}

// call before repainting the life screen (theme, layout or starting life may have changed)
void prepLifeBg() {
  const CustomTheme *c = activeCustom();
  bgRing = ringColor();
  bgDim  = fb.alphaBlend(115, bgRing, TFT_BLACK);
  bgThin = fb.alphaBlend(153, bgRing, TFT_BLACK);
  bgHintMinus = c ? c->minus : TFT_RED;
  bgHintPlus  = c ? c->plus : TFT_GREEN;
  if (lifeLayout == L_HALO) {
    uint16_t acc = accentColor();
    for (int i = 0; i < HALO_N; i++) {
      float r = sqrtf(i * 64.0f + 32) / 120.0f;
      float a = r < 0.55f ? 0.24f - 0.16f * r / 0.55f : (r < 1 ? 0.08f * (1 - (r - 0.55f) / 0.45f) : 0);
      haloLut[i] = swap16(fb.alphaBlend((uint8_t)(a * 255), acc, TFT_BLACK));
    }
  }
  barShownDeg = barDeg();
  barShownCol = lifeColor(life);
  prepTicks();
}

inline uint16_t hintPx(uint16_t col, uint16_t baseSw) {
  return swap16(fb.alphaBlend(115, col, swap16(baseSw)));
}

// one background pixel of the life screen (byte-swapped, like fbPix)
uint16_t lifeBgPixel(int x, int y, const CustomTheme *c, const uint8_t *img) {
  int dx = x - CX, dy = y - CY, r2 = dx * dx + dy * dy;
  uint16_t base = c ? ctPal[img[y * W + x]] : (lifeLayout == L_HALO ? haloLut[min(r2 >> 6, HALO_N - 1)] : 0);
  switch (lifeLayout) {
    case L_CLASSIC:
    case L_HISTORY:
      if (!c && r2 >= RING_LO && r2 <= RING_HI) return swap16(bgRing);
      break;
    case L_HALO:
      if (!c && r2 >= THIN_LO && r2 <= THIN_HI) return swap16(bgThin);
      break;
    case L_HINTS:                       // ring open at the bottom, faint - and + at the sides
      if (!c && r2 >= RING_LO && r2 <= RING_HI) {
        float a = angTop(dx, dy);
        if (a < 160 || a > 200) return swap16(bgRing);
      }
      if (dy >= -2 && dy <= 2 && dx >= -88 && dx <= -72) return hintPx(bgHintMinus, base);
      if ((dy >= -2 && dy <= 2 && dx >= 72 && dx <= 88) || (dx >= 78 && dx <= 82 && dy >= -8 && dy <= 8))
        return hintPx(bgHintPlus, base);
      break;
    case L_LIFEBAR:                     // lit part = life / starting life
      if (r2 >= RING_LO && r2 <= RING_HI) {
        if (angTop(dx, dy) < barShownDeg) return swap16(barShownCol);
        if (!c) return swap16(bgDim);
      }
      break;
    case L_TICKS:                       // 24 ticks, one per life on the slider
      if (r2 >= TICK_LO && r2 <= TICK_HI) {
        float a = angTop(dx, dy);
        int k = (int)lroundf(a / 15.0f);
        float off = fabsf(a - k * 15.0f) * (PI / 180.0f) * sqrtf((float)r2);
        k %= 24;
        if (off <= (tickLit[k] ? 2.0f : 1.5f)) return swap16(tickCol[k]);
      }
      break;
  }
  return base;
}

// Repaints a rect of the screen background (life screen: per layout; menus: black or
// the custom image). Does not mark it dirty.
void restoreBg(int x, int y, int w, int h) {
  if (x < 0) { w += x; x = 0; }
  if (y < 0) { h += y; y = 0; }
  if (x + w > W) w = W - x;
  if (y + h > H) h = H - y;
  if (w <= 0 || h <= 0) return;
  const CustomTheme *c = bgCustom();
  const uint8_t *img = c ? ctPixels(theme - THEME_COUNT) : nullptr;
  if (screen != S_LIFE) {
    if (!c) { fb.fillRect(x, y, w, h, TFT_BLACK); return; }
    for (int yy = y; yy < y + h; yy++) {
      uint16_t *d = fbPix + yy * W + x;
      const uint8_t *src = img + yy * W + x;
      for (int i = 0; i < w; i++) d[i] = ctPal[src[i]];
    }
    return;
  }
  for (int yy = y; yy < y + h; yy++) {
    uint16_t *d = fbPix + yy * W + x;
    for (int i = 0; i < w; i++) d[i] = lifeBgPixel(x + i, yy, c, img);
  }
}

// repaints the background ring pixels (rIn..rOut) between angles a0..a1 (from the top,
// clockwise) and marks their bounding box dirty
void repaintRim(float a0, float a1, int rIn, int rOut) {
  int x0 = W, y0 = H, x1 = -1, y1 = -1;
  if (a1 - a0 >= 360) { x0 = CX - rOut; y0 = CY - rOut; x1 = CX + rOut; y1 = CY + rOut; }
  else {
    for (float a = a0; ; a += 5) {
      if (a > a1) a = a1;
      float s = sinf(a * PI / 180), co = cosf(a * PI / 180);
      for (int r = rIn; r <= rOut; r += rOut - rIn) {
        int px = CX + (int)lroundf(r * s), py = CY - (int)lroundf(r * co);
        x0 = min(x0, px); x1 = max(x1, px); y0 = min(y0, py); y1 = max(y1, py);
      }
      if (a >= a1) break;
    }
  }
  x0 = max(x0 - 3, 0); y0 = max(y0 - 3, 0); x1 = min(x1 + 3, W - 1); y1 = min(y1 + 3, H - 1);
  const CustomTheme *c = bgCustom();
  const uint8_t *img = c ? ctPixels(theme - THEME_COUNT) : nullptr;
  int lo = rIn * rIn - rIn, hi = rOut * rOut + rOut;
  for (int y = y0; y <= y1; y++)
    for (int x = x0; x <= x1; x++) {
      int dx = x - CX, dy = y - CY, r2 = dx * dx + dy * dy;
      if (r2 >= lo && r2 <= hi) fbPix[y * W + x] = lifeBgPixel(x, y, c, img);
    }
  markDirty(x0, y0, x1 - x0 + 1, y1 - y0 + 1);
}

// Draws `s` centered on (cx, cy). Anti-aliasing blends with black, or with what is
// already in the framebuffer when a custom background is showing. `grad` (3 colors,
// top / middle / bottom) paints a vertical gradient instead of `color`.
void drawBig(const BigFont &f, const String &s, int cx, int cy, uint16_t color,
             const uint16_t *grad = nullptr) {
  int minX, maxX;
  bigExtent(f, s, minX, maxX);
  int x0 = cx - (maxX - minX) / 2 - minX;
  int y0 = cy - (f.top + f.height / 2);
  bool blend = screen == S_LIFE;         // blend with the background already in the framebuffer
  uint16_t shade[16];
  for (int a = 0; a < 16; a++) shade[a] = fb.alphaBlend(a * 17, color, TFT_BLACK);
  int pen = 0;
  for (unsigned i = 0; i < s.length(); i++) {
    const BigGlyph *g = bigGlyph(f, s[i]);
    if (!g) continue;
    const uint8_t *bm = f.bitmap + g->off;
    int gx = x0 + pen + g->dx, gy = y0 + g->dy;
    for (int y = 0, k = 0; y < g->h; y++) {
      int py = gy + y;
      uint16_t c = color;
      if (grad) {                       // position within the font's digit box
        int t = constrain((py - (y0 + f.top)) * 510 / max(1, (int)f.height), 0, 510);
        c = t < 255 ? fb.alphaBlend(t, grad[1], grad[0]) : fb.alphaBlend(t - 255, grad[2], grad[1]);
      }
      for (int x = 0; x < g->w; x++, k++) {
        int a = (k & 1) ? (bm[k >> 1] & 0x0F) : (bm[k >> 1] >> 4);
        if (!a) continue;
        int px = gx + x;
        if (px < 0 || px >= W || py < 0 || py >= H) continue;
        if (!blend && !grad) { fb.drawPixel(px, py, shade[a]); continue; }
        uint16_t bg = blend ? swap16(fbPix[py * W + px]) : TFT_BLACK;
        fb.drawPixel(px, py, a == 15 ? c : fb.alphaBlend(a * 17, c, bg));
      }
    }
    pen += g->adv;
  }
}

void drawRing() {
  // guide ring showing where the slider lives (theme color); custom images have their own
  if (lifeCustom()) return;
  for (int r = 107; r <= 110; r++) fb.drawCircle(CX, CY, r, ringColor());
}

// The dot (r 90..106 from center) never touches the ring (r 106.5..110.5).
void redrawMarkerIfIn(int x, int y, int w, int h) {
  if (markerX < 0 || markerX + 9 < x || markerX - 9 >= x + w || markerY + 9 < y || markerY - 9 >= y + h) return;
  fb.fillCircle(markerX, markerY, 8, accentColor());
  markDirty(markerX - 9, markerY - 9, 19, 19);
}

void drawMarker() {
  if (wantMarkerX == markerX && wantMarkerY == markerY) return;
  if (markerX >= 0) {
    int ex = markerX - 9, ey = markerY - 9;
    markerX = markerY = -1;
    restoreBg(ex, ey, 19, 19);
    markDirty(ex, ey, 19, 19);
    repaintOverlaps(ex, ey, 19, 19);    // the dot may have covered part of the number / text
  }
  if (wantMarkerX >= 0) {
    fb.fillCircle(wantMarkerX, wantMarkerY, 8, accentColor());
    markDirty(wantMarkerX - 9, wantMarkerY - 9, 19, 19);
  }
  markerX = wantMarkerX;
  markerY = wantMarkerY;
}

// L_TICKS: the ticks near the finger light up (no dot)
void drawTicks() {
  if (tickWant == tickShown) return;
  float old = tickShown;
  tickShown = tickWant;
  prepTicks();
  if (old >= 0) repaintRim(old - 45, old + 45, 100, 111);
  if (tickShown >= 0) repaintRim(tickShown - 45, tickShown + 45, 100, 111);
}

uint16_t lifeColor(int v) {
  const CustomTheme *c = lifeCustom();
  if (v <= 0)  return c ? c->warn[2] : TFT_RED;
  if (v <= 5)  return c ? c->warn[1] : TFT_ORANGE;
  if (v <= 10) return c ? c->warn[0] : TFT_YELLOW;
  return c ? c->num : TFT_WHITE;
}

const int LIFE_W = 200, LIFE_H = 82;   // area cleared behind the big number
int numY()   { return lifeLayout == L_HISTORY ? CY - 16 : CY; }
int deltaY() { return lifeLayout == L_HISTORY ? CY - 76 : CY - 62; }

// draws `v` with the chosen font: XL when it fits, else L (fits -999..999)
// Custom themes add their effect (shadow / gradient) while the color is the normal one.
void drawNumber(int v, int cy, uint16_t color) {
  String s = String(v);
  const FontChoice &fc = FONTS[fontIdx];
  const BigFont &f = bigWidth(*fc.xl, s) <= LIFE_W - 4 ? *fc.xl : *fc.l;
  const CustomTheme *c = lifeCustom();
  if (c && color == c->num && c->fx == FX_SHADOW) {
    int dx = constrain(c->fxDx, -3, 3), dy = constrain(c->fxDy, -3, 3);
    drawBig(f, s, CX + dx, cy + dy, c->fxColor[0]);
  }
  bool grad = c && color == c->num && c->fx == FX_GRAD;
  drawBig(f, s, CX, cy, color, grad ? c->fxColor : nullptr);
}

void paintNumber() {
  int y = numY() - LIFE_H / 2;
  restoreBg(CX - LIFE_W / 2, y, LIFE_W, LIFE_H);
  drawNumber(life, numY(), lifeColor(life));
  markDirty(CX - LIFE_W / 2, y, LIFE_W, LIFE_H);
  redrawMarkerIfIn(CX - LIFE_W / 2, y, LIFE_W, LIFE_H);
}

void drawLife() {
  paintNumber();
  if (lifeLayout == L_LIFEBAR) {         // the ring follows life / starting life
    float nd = barDeg();
    uint16_t nc = lifeColor(life);
    if (nc != barShownCol) { barShownDeg = nd; barShownCol = nc; repaintRim(0, 360, 107, 110); }
    else if (nd != barShownDeg) {
      float a0 = min(nd, barShownDeg), a1 = max(nd, barShownDeg);
      barShownDeg = nd;
      repaintRim(a0, a1, 107, 110);
    }
  }
}

const int DELTA_W = 90, DELTA_H = 30;

void drawDelta() {
  int y = deltaY();
  restoreBg(CX - DELTA_W / 2, y - DELTA_H / 2, DELTA_W, DELTA_H);
  if (pendingDelta != 0) {
    String s = (pendingDelta > 0 ? "+" : "") + String(pendingDelta);
    const CustomTheme *c = lifeCustom();
    fb.setTextDatum(MC_DATUM);
    fb.setTextPadding(0);
    fb.setTextColor(pendingDelta > 0 ? (c ? c->plus : TFT_GREEN) : (c ? c->minus : TFT_RED));
    fb.drawString(s, CX, y, 4);
  }
  markDirty(CX - DELTA_W / 2, y - DELTA_H / 2, DELTA_W, DELTA_H);
  redrawMarkerIfIn(CX - DELTA_W / 2, y - DELTA_H / 2, DELTA_W, DELTA_H);
}

// L_HISTORY: a thin line under the number and the last changes
const int HIST_X = 50, HIST_Y = 146, HIST_W = 140, HIST_H = 32;

void paintHistory() {
  if (screen != S_LIFE || lifeLayout != L_HISTORY) return;
  restoreBg(HIST_X, HIST_Y, HIST_W, HIST_H);
  const CustomTheme *c = lifeCustom();
  fb.drawFastHLine(64, 152, 112, c ? c->fill : BTN_FILL);
  fb.drawFastHLine(64, 153, 112, c ? c->fill : BTN_FILL);
  fb.setTextDatum(MC_DATUM);
  fb.setTextPadding(0);
  for (int i = 0; i < histCount; i++) {
    int v = hist[i];
    uint16_t col = v > 0 ? (c ? c->plus : TFT_GREEN) : (c ? c->minus : TFT_RED);
    if (!c) col = fb.alphaBlend(190, col, TFT_BLACK);
    fb.setTextColor(col);
    int x = CX + (2 * i - (histCount - 1)) * 21;
    fb.drawString((v > 0 ? "+" : "") + String(v), x, 168, 2);
  }
  markDirty(HIST_X, HIST_Y, HIST_W, HIST_H);
  redrawMarkerIfIn(HIST_X, HIST_Y, HIST_W, HIST_H);
}

void pushHistory(int v) {
  if (histCount == HIST_N) { for (int i = 1; i < HIST_N; i++) hist[i - 1] = hist[i]; histCount--; }
  hist[histCount++] = v;
  paintHistory();
}

// Approximate reading; battery is behind a 1/2 divider on A0.
int batteryPercent() {
  analogReference(AR_INTERNAL_2_4);
  analogReadResolution(12);
  long raw = 0;
  for (int i = 0; i < 16; i++) raw += analogRead(BATTERY_PIN);
  raw /= 16;
  float volts = raw * 2.4f / 4095.0f * 2.0f;
  int pct = (int)((volts - 3.3f) / (4.2f - 3.3f) * 100.0f);
  return constrain(pct, 0, 100);
}

// USB power present. The Round Display's charger has no status line to the MCU,
// so "USB connected" is the best "charging" signal available.
bool usbPowered() {
  return (NRF_POWER->USBREGSTATUS & POWER_USBREGSTATUS_VBUSDETECT_Msk) != 0;
}
bool shownUsb = false;

// small lightning bolt centered on (bx, by), 14 px tall
void drawBolt(int bx, int by, uint16_t color) {
  fb.fillTriangle(bx + 3, by - 7, bx - 4, by + 1, bx + 1, by + 1, color);
  fb.fillTriangle(bx - 1, by - 1, bx + 4, by - 1, bx - 3, by + 7, color);
}

// reads the battery and updates the low-battery mode (does not touch the backlight)
void readBattery() {
  batPct = batteryPercent();
  shownUsb = usbPowered();
  bool usb = shownUsb;
#if DEBUG
  if (batOverride >= 0) { batPct = batOverride; usb = false; }
#endif
  bool low = !usb && (lowBattery ? batPct < LOW_BAT_OFF : batPct <= LOW_BAT_ON);
  if (low != lowBattery) DBG("low battery mode %s (%d%%)", low ? "on" : "off", batPct);
  lowBattery = low;
}

// where the battery goes on each layout
void batteryBox(int &x, int &y, int &w, int &h) {
  switch (lifeLayout) {
    case L_TICKS:   x = 72; y = 176; w = 96; h = 37; break;          // short arc at the bottom
    case L_HINTS:   x = CX - 32; y = CY + 85; w = 64; h = 18; break; // in the ring's gap
    case L_HISTORY: x = CX - 40; y = CY + 73; w = 80; h = 18; break;
    default:        x = CX - 40; y = CY + 72; w = 80; h = 18; break;
  }
}

void paintBattery() {
  if (screen != S_LIFE) return;         // menu covers it; redrawn when the menu closes
  int bx, by, bw, bh;
  batteryBox(bx, by, bw, bh);
  restoreBg(bx, by, bw, bh);
  const CustomTheme *c = lifeCustom();
  uint16_t col = lowBattery ? (c ? c->minus : TFT_RED) : (c ? c->muted : GREY);
  if (lifeLayout == L_TICKS) {
    // arc from 150 to 210 degrees (from the top, clockwise); TFT_eSPI angles start at the bottom
    uint16_t bg = c ? swap16(fbPix[(by + bh / 2) * W + CX]) : TFT_BLACK;
    fb.drawArc(CX, CY, 90, 87, 330, 30, c ? c->fill : BTN_FILL, bg, !c);
    if (batPct > 0) fb.drawArc(CX, CY, 90, 87, (30 - batPct * 60 / 100 + 360) % 360, 30, col, bg, !c);
    if (shownUsb) drawBolt(CX, 186, TFT_YELLOW);
  } else {
    fb.setTextDatum(MC_DATUM);
    fb.setTextPadding(0);
    fb.setTextColor(col);
    String txt = String(batPct) + "%";
    int ty = by + 8;
    int tx = shownUsb ? CX + 8 : CX;    // make room for the bolt
    fb.drawString(txt, tx, ty, 2);
    if (shownUsb) drawBolt(tx - fb.textWidth(txt, 2) / 2 - 9, ty, TFT_YELLOW);
  }
  markDirty(bx, by, bw, bh);
  redrawMarkerIfIn(bx, by, bw, bh);
}

void drawBattery() {
  readBattery();
  paintBattery();
}

// after erasing the dot: repaint whatever it may have covered
void repaintOverlaps(int x, int y, int w, int h) {
  if (screen != S_LIFE) return;
  auto hit = [&](int bx, int by, int bw, int bh) {
    return x < bx + bw && bx < x + w && y < by + bh && by < y + h;
  };
  if (hit(CX - LIFE_W / 2, numY() - LIFE_H / 2, LIFE_W, LIFE_H)) paintNumber();
  if (hit(CX - DELTA_W / 2, deltaY() - DELTA_H / 2, DELTA_W, DELTA_H)) drawDelta();
  int bx, by, bw, bh;
  batteryBox(bx, by, bw, bh);
  if (hit(bx, by, bw, bh)) paintBattery();
  if (lifeLayout == L_HISTORY && hit(HIST_X, HIST_Y, HIST_W, HIST_H)) paintHistory();
}

// draws the whole life screen into the framebuffer (no flush)
void paintLife() {
  prepLifeBg();
  markerX = markerY = -1;
  restoreBg(0, 0, W, H);                // ring / ticks / hints / halo / life bar included
  paintNumber();
  drawDelta();
  drawBattery();
  paintHistory();
  drawMarker();
  markDirty(0, 0, W, H);
  lifeDirty = deltaDirty = false;
}

void fullRedraw() {
  paintLife();
  flush();
}

// ================= Menu & dice =================

// normal button border: grey, or the theme color when a mana theme is on
uint16_t btnBorder() {
  return theme == 0 ? GREY : accentColor();
}

// ---- icons (about 28x28, centered on cx, cy; bg is used for anti-aliasing) ----
const uint16_t MANA[5] = { 0xFFB9, 0x3CBF, 0xAADB, 0xFA26, 0x3E8B };   // W U B R G

// `k` scales the icon (carousel / list); `fade` dims the mana colors like `c` was dimmed
void drawIcon(uint8_t icon, int cx, int cy, uint16_t c, uint16_t bg, float k = 1, uint8_t fade = 255) {
  auto S = [k](float v) { return (int)lroundf(v * k); };
  switch (icon) {
    case I_RESET: {                       // circular arrow, clockwise, gap at the top
      const float r = 11 * k;
      fb.drawArc(cx, cy, S(12), S(9), 215, 145, c, bg, true);   // TFT_eSPI angles: 0 = bottom, clockwise
      float a = 145 * PI / 180;           // arrowhead at the upper-left end, pointing clockwise
      float px = cx - r * sinf(a), py = cy + r * cosf(a);
      float dx = -cosf(a), dy = -sinf(a); // clockwise tangent
      float rx = -sinf(a), ry = cosf(a);  // outward radius
      fb.fillTriangle(px + dx * 7 * k, py + dy * 7 * k,
                      px - dx * 2 * k + rx * 6 * k, py - dy * 2 * k + ry * 6 * k,
                      px - dx * 2 * k - rx * 6 * k, py - dy * 2 * k - ry * 6 * k, c);
      break;
    }
    case I_DICE: {                        // die face showing 5
      fb.fillSmoothRoundRect(cx - S(13), cy - S(13), S(26), S(26), S(5), c, bg);
      fb.fillSmoothRoundRect(cx - S(10), cy - S(10), S(20), S(20), S(3), bg, c);
      const int o = S(6), pr = max(2, S(2));
      fb.fillSmoothCircle(cx, cy, pr, c, bg);
      fb.fillSmoothCircle(cx - o, cy - o, pr, c, bg); fb.fillSmoothCircle(cx + o, cy - o, pr, c, bg);
      fb.fillSmoothCircle(cx - o, cy + o, pr, c, bg); fb.fillSmoothCircle(cx + o, cy + o, pr, c, bg);
      break;
    }
    case I_SUN:
      fb.fillSmoothCircle(cx, cy, S(6), c, bg);
      for (int i = 0; i < 8; i++) {
        float a = i * PI / 4, ca = cosf(a), sa = sinf(a);
        fb.drawWideLine(cx + 9 * k * ca, cy + 9 * k * sa, cx + 13 * k * ca, cy + 13 * k * sa, 2.5f * k, c, bg);
      }
      break;
    case I_PALETTE:                       // the five mana colors in a ring
      for (int i = 0; i < 5; i++) {
        float a = -PI / 2 + i * 2 * PI / 5;
        uint16_t m = fade == 255 ? MANA[i] : fb.alphaBlend(fade, MANA[i], TFT_BLACK);
        fb.fillSmoothCircle(cx + (int)roundf(9 * k * cosf(a)), cy + (int)roundf(9 * k * sinf(a)), S(4), m, bg);
      }
      break;
    case I_BACK:                          // arrow pointing left
      fb.drawWideLine(cx - S(4), cy, cx + S(12), cy, 4 * k, c, bg);
      fb.fillTriangle(cx - S(13), cy, cx - S(3), cy - S(9), cx - S(3), cy + S(9), c);
      break;
    case I_CHECK:
      fb.drawWideLine(cx - 10, cy, cx - 3, cy + 7, 4, c, bg);
      fb.drawWideLine(cx - 3, cy + 7, cx + 11, cy - 8, 4, c, bg);
      break;
    case I_MOON:                          // crescent: a disc with a bite out of it
      fb.fillSmoothCircle(cx, cy, 9, c, bg);
      fb.fillSmoothCircle(cx + 5, cy - 4, 8, bg, bg);
      break;
    case I_INF:                           // infinity: two loops
      for (int s = -1; s <= 1; s += 2) {
        fb.fillSmoothCircle(cx + s * 7, cy, 7, c, bg);
        fb.fillSmoothCircle(cx + s * 7, cy, 4, bg, c);
      }
      break;
    case I_LEFT:
      fb.fillTriangle(cx - 9, cy, cx + 7, cy - 11, cx + 7, cy + 11, c);
      break;
    case I_RIGHT:
      fb.fillTriangle(cx + 9, cy, cx - 7, cy - 11, cx - 7, cy + 11, c);
      break;
    case I_BT: {                          // Bluetooth rune
      float w = 2.5f * k;
      int a = S(6), b = S(12);
      fb.drawWideLine(cx - a, cy - a, cx + a, cy + a, w, c, bg);
      fb.drawWideLine(cx + a, cy + a, cx, cy + b, w, c, bg);
      fb.drawWideLine(cx, cy + b, cx, cy - b, w, c, bg);
      fb.drawWideLine(cx, cy - b, cx + a, cy - a, w, c, bg);
      fb.drawWideLine(cx + a, cy - a, cx - a, cy + a, w, c, bg);
      break;
    }
    case I_LAYOUT:                        // round screen with a 2x2 grid
      fb.fillSmoothCircle(cx, cy, 12, c, bg);
      fb.fillSmoothCircle(cx, cy, 10, bg, c);
      fb.fillRect(cx - 6, cy - 6, 5, 5, c); fb.fillRect(cx + 1, cy - 6, 5, 5, c);
      fb.fillRect(cx - 6, cy + 1, 5, 5, c); fb.fillRect(cx + 1, cy + 1, 5, 5, c);
      break;
    default: break;
  }
}

void drawButton(const Btn &b, uint16_t border) {
  fb.fillRoundRect(b.x, b.y, b.w, b.h, 10, BTN_FILL);
  fb.drawRoundRect(b.x, b.y, b.w, b.h, 10, border);
  if (b.icon) { drawIcon(b.icon, b.x + b.w / 2, b.y + b.h / 2, TFT_WHITE, BTN_FILL); return; }
  fb.setTextDatum(MC_DATUM);
  fb.setTextPadding(0);
  fb.setTextColor(TFT_WHITE, BTN_FILL);
  int font = fb.textWidth(b.label, 4) <= b.w - 6 ? 4 : 2;        // font 4 = 26 px
  fb.drawString(b.label, b.x + b.w / 2, b.y + b.h / 2 + 1, font);
}

// index of the button under (x, y), or -1
int buttonAt(const Btn *btns, int n, int x, int y) {
  for (int i = 0; i < n; i++) {
    const Btn &b = btns[i];
    if (x >= b.x - 3 && x < b.x + b.w + 3 && y >= b.y - 3 && y < b.y + b.h + 3) return i;
  }
  return -1;
}

// Main menu: 4 rows of 40 px (+8 px gaps), icons except "20" / "40" / "Aa".
enum MenuItem { M_RESET, M_FONT, M_20, M_40, M_DICE, M_LIGHT, M_THEME, M_BACK, M_COUNT };
const Btn MENU_BTNS[M_COUNT] = {
  { 50,  28,  66, 40, nullptr, I_RESET },
  { 124, 28,  66, 40, "Aa" },
  { 50,  76,  66, 40, "20" },
  { 124, 76,  66, 40, "40" },
  { 50, 124,  66, 40, nullptr, I_DICE },
  { 124, 124, 66, 40, nullptr, I_SUN },
  { 50, 172,  66, 40, nullptr, I_PALETTE },
  { 124, 172, 66, 40, nullptr, I_BACK },
};

// Theme picker: 3x2 built-in swatches, a row with the custom slots (a thumbnail of
// the background sent from the web page, or "-" when empty) and "Voltar".
const char *THEME_LABELS[] = { "-", "W", "U", "B", "R", "G" };
const int THEME_BTN_COUNT = 6 + CT_SLOTS + 3;
const Btn THEME_BTNS[THEME_BTN_COUNT] = {
  { 28,  34, 56, 44, nullptr }, { 92,  34, 56, 44, nullptr }, { 156,  34, 56, 44, nullptr },
  { 28,  84, 56, 44, nullptr }, { 92,  84, 56, 44, nullptr }, { 156,  84, 56, 44, nullptr },
  { 44, 134, 72, 48, nullptr }, { 124, 134, 72, 48, nullptr },
  { 53, 188, 42, 30, nullptr, I_BT }, { 99, 188, 42, 30, nullptr, I_LAYOUT }, { 145, 188, 42, 30, nullptr, I_BACK },
};
const int THEME_BT = THEME_BTN_COUNT - 3, THEME_LAYOUT = THEME_BTN_COUNT - 2, THEME_BACK = THEME_BTN_COUNT - 1;

// Font picker: a test number in the candidate font, dots for the position, and
// < OK > underneath. The font changes live; OK saves. The test number starts at
// the life total and changes like life does (tap right/left of it, hold, rim)
// without touching the real life total.
enum { F_PREV, F_OK, F_NEXT, F_COUNT };
const Btn FONT_BTNS[F_COUNT] = {
  { 40, 164, 50, 40, nullptr, I_LEFT },
  { 95, 164, 50, 40, nullptr, I_CHECK },
  { 150, 164, 50, 40, nullptr, I_RIGHT },
};
const int FONT_SAMPLE_Y = CY - 12;

// Dice picker: 3x2 grid of dice + "Voltar".
const int DICE_COUNT = 6;
const int DICE_SIDES[DICE_COUNT] = { 4, 6, 8, 10, 12, 20 };
const Btn DICE_BTNS[DICE_COUNT + 1] = {
  { 28,  48, 56, 48, "d4" },  { 92,  48, 56, 48, "d6" },  { 156,  48, 56, 48, "d8" },
  { 28, 104, 56, 48, "d10" }, { 92, 104, 56, 48, "d12" }, { 156, 104, 56, 48, "d20" },
  { 60, 164, 120, 40, nullptr, I_BACK },
};

void showScreen(Screen s) {
  screen = s;
  wantMarkerX = wantMarkerY = -1;
  tickWant = -1;
  if (bgCustom()) restoreBg(0, 0, W, H);
  else fb.fillSprite(TFT_BLACK);
  markerX = markerY = -1;
}

// ---- main menu, in 6 layouts ----
const uint8_t ITEM_ICON[M_COUNT] = { I_RESET, I_NONE, I_NONE, I_NONE, I_DICE, I_SUN, I_PALETTE, I_BACK };
const char *ITEM_TEXT[M_COUNT] = { nullptr, "Aa", "20", "40", nullptr, nullptr, nullptr, nullptr };
const char *ITEM_NAME[M_COUNT] = { "Reiniciar", "Fonte", "20 vidas", "40 vidas", "Dado", "Brilho", "Tema", "Voltar" };
const float SLICE_DEG = 360.0f / 7;     // radial / slices: items 0..6 around, "back" in the center
// circles 3-3-2, "back" in the middle, reset at the bottom
const int CELL_X[M_COUNT] = { 150, 60, 60, 180, 120, 180, 90, 120 };
const int CELL_Y[M_COUNT] = { 180, 60, 120, 120, 60, 60, 180, 120 };

bool isCurrentStart(int i) { return (i == M_20 && startingLife == 20) || (i == M_40 && startingLife == 40); }
uint16_t itemBorder(int i) {
  if (i == M_RESET) return TFT_ORANGE;
  return isCurrentStart(i) ? TFT_GREEN : btnBorder();
}
inline uint16_t faded(uint16_t c, uint8_t fade) { return fade == 255 ? c : fb.alphaBlend(fade, c, TFT_BLACK); }

// icon or text of a menu item, centered on (cx, cy)
void drawItem(int i, int cx, int cy, uint16_t bg, float k = 1, uint8_t fade = 255) {
  uint16_t c = faded(TFT_WHITE, fade);
  if (ITEM_ICON[i]) { drawIcon(ITEM_ICON[i], cx, cy, c, bg, k, fade); return; }
  fb.setTextDatum(MC_DATUM);
  fb.setTextPadding(0);
  fb.setTextColor(c);
  if (k > 1.5f) { fb.setFreeFont(&FreeSansBold18pt7b); fb.drawString(ITEM_TEXT[i], cx, cy); fb.setTextFont(1); }
  else fb.drawString(ITEM_TEXT[i], cx, cy + 1, k < 1 ? 2 : 4);
}

// round button; the anti-aliasing blends with the pixel just above it
void drawCircleItem(int i, int cx, int cy, int r, uint16_t border, uint8_t fade = 255) {
  int sy = max(0, cy - r - 2);
  uint16_t under = swap16(fbPix[sy * W + cx]);
  uint16_t fill = faded(BTN_FILL, fade);
  fb.fillSmoothCircle(cx, cy, r, faded(border, fade), under);
  fb.fillSmoothCircle(cx, cy, r - 2, fill, faded(border, fade));
  drawItem(i, cx, cy, fill, 1, fade);
}

void slicePos(int i, int r, int &x, int &y) {
  float a = i * SLICE_DEG * PI / 180;
  x = CX + (int)lroundf(r * sinf(a));
  y = CY - (int)lroundf(r * cosf(a));
}

void paintSlices() {
  uint16_t ring = ringColor();
  uint16_t fill = fb.alphaBlend(90, ring, BTN_FILL), edge = fb.alphaBlend(204, ring, BTN_FILL);
  const float half = SLICE_DEG / 2 - 2;
  for (int y = 0; y < H; y++)
    for (int x = 0; x < W; x++) {
      int dx = x - CX, dy = y - CY, r2 = dx * dx + dy * dy;
      if (r2 < 52 * 52 || r2 > 116 * 116) continue;
      float a = angTop(dx, dy);
      int k = (int)lroundf(a / SLICE_DEG);
      float off = fabsf(a - k * SLICE_DEG);
      if (off > half) continue;
      k %= 7;
      float r = sqrtf((float)r2);
      float e = min(min(r - 52, 116 - r), (half - off) * (PI / 180) * r);
      uint16_t border = (k == M_RESET || isCurrentStart(k)) ? itemBorder(k) : edge;
      fb.drawPixel(x, y, e < 1.5f ? border : fill);
    }
  for (int i = 0; i < 7; i++) { int x, y; slicePos(i, 85, x, y); drawItem(i, x, y, fill); }
  drawCircleItem(M_BACK, CX, CY, 44, btnBorder());
}

void paintCarousel() {
  if (!bgCustom()) drawRing();
  int prev = (menuCur + M_COUNT - 1) % M_COUNT, next = (menuCur + 1) % M_COUNT;
  drawCircleItem(prev, 40, 108, 22, itemBorder(prev), 115);
  drawCircleItem(next, 200, 108, 22, itemBorder(next), 115);
  fb.fillSmoothCircle(CX, 108, 44, itemBorder(menuCur) == btnBorder() ? accentColor() : itemBorder(menuCur),
                      swap16(fbPix[60 * W + CX]));
  fb.fillSmoothCircle(CX, 108, 42, BTN_FILL, accentColor());
  drawItem(menuCur, CX, 108, BTN_FILL, 1.8f);
  fb.setTextDatum(MC_DATUM);
  fb.setTextPadding(0);
  fb.setTextColor(TFT_WHITE);
  fb.drawString(ITEM_NAME[menuCur], CX, 172, 4);
  for (int i = 0; i < M_COUNT; i++) {
    int x = CX + (int)lroundf((i - 3.5f) * 11);
    if (i == menuCur) fb.fillSmoothCircle(x, 198, 3, accentColor(), TFT_BLACK);
    else fb.fillSmoothCircle(x, 198, 2, GREY, TFT_BLACK);
  }
}

void paintList() {
  uint16_t under = swap16(fbPix[CY * W + 230]);
  fb.drawArc(CX, CY, 110, 107, 240, 300, ringColor(), under, !bgCustom());   // right side: "scroll here"
  for (int o = -2; o <= 2; o++) {
    int i = (menuCur + o + M_COUNT) % M_COUNT, y = CY + o * 44;
    uint8_t fade = o == 0 ? 255 : (abs(o) == 1 ? 153 : 64);
    uint16_t bg = swap16(fbPix[y * W + 40]);
    if (o == 0) {
      fb.fillRoundRect(34, y - 21, 172, 42, 12, BTN_FILL);
      fb.drawRoundRect(34, y - 21, 172, 42, 12, accentColor());
      bg = BTN_FILL;
    }
    drawItem(i, o == 0 ? 62 : 72, y, bg, o == 0 ? 1 : 0.8f, fade);
    fb.setTextDatum(ML_DATUM);
    fb.setTextPadding(0);
    fb.setTextColor(faded(TFT_WHITE, fade));
    fb.drawString(ITEM_NAME[i], o == 0 ? 88 : 94, y + 1, o == 0 ? 4 : 2);
    if (isCurrentStart(i)) fb.fillSmoothCircle(o == 0 ? 190 : 182, y, 4, faded(TFT_GREEN, fade), bg);
  }
}

// draws the main menu into the framebuffer (no flush)
void paintMenu() {
  showScreen(S_MENU);
  switch (menuLayout) {
    case ML_GRID:
      for (int i = 0; i < M_COUNT; i++) drawButton(MENU_BTNS[i], itemBorder(i));
      break;
    case ML_RADIAL:
      fb.drawCircle(CX, CY, 80, BTN_FILL);
      fb.drawCircle(CX, CY, 79, BTN_FILL);
      for (int i = 0; i < 7; i++) { int x, y; slicePos(i, 80, x, y); drawCircleItem(i, x, y, 25, itemBorder(i)); }
      drawCircleItem(M_BACK, CX, CY, 24, btnBorder());
      break;
    case ML_SLICES:   paintSlices(); break;
    case ML_CAROUSEL: paintCarousel(); break;
    case ML_CIRCLES:
      for (int i = 0; i < M_COUNT; i++) drawCircleItem(i, CELL_X[i], CELL_Y[i], 25, i == M_BACK ? btnBorder() : itemBorder(i));
      break;
    case ML_LIST:     paintList(); break;
  }
  markDirty(0, 0, W, H);
}

void drawMenu() {
  paintMenu();
  flush();
}

// item under (x, y) for the layouts with fixed buttons, or -1
int menuHit(int x, int y) {
  auto near = [&](int cx, int cy, int r) { int dx = x - cx, dy = y - cy; return dx * dx + dy * dy <= r * r; };
  switch (menuLayout) {
    case ML_GRID:
      return buttonAt(MENU_BTNS, M_COUNT, x, y);
    case ML_RADIAL:
      if (near(CX, CY, 28)) return M_BACK;
      for (int i = 0; i < 7; i++) { int px, py; slicePos(i, 80, px, py); if (near(px, py, 29)) return i; }
      return -1;
    case ML_SLICES: {
      int d = distOf(x, y);
      if (d < 48) return M_BACK;
      if (d > 125) return -1;
      return (int)lroundf(angTop(x - CX, y - CY) / SLICE_DEG) % 7;
    }
    case ML_CIRCLES:
      for (int i = 0; i < M_COUNT; i++) if (near(CELL_X[i], CELL_Y[i], 29)) return i;
      return -1;
  }
  return -1;
}

// ---- layout picker (Menu > Tema > Layout) ----
// Live thumbnails of the life screen and the menu: tap one to try the next layout.
// "Fundo" toggles the custom image behind the menu; OK saves.
const int THUMB_R = 46, THUMB_D = 2 * THUMB_R + 1, THUMB_Y = 98;
const int THUMB_X[2] = { 66, 174 };
uint16_t thumbs[2][THUMB_D * THUMB_D];  // byte-swapped, like fbPix
enum { LY_LIFE, LY_MENU, LY_BG, LY_OK, LY_COUNT };
const Btn LAYOUT_BTNS[LY_COUNT] = {
  { 20, 52, 92, 92, nullptr }, { 128, 52, 92, 92, nullptr },
  { 54, 188, 62, 30, nullptr }, { 124, 188, 62, 30, nullptr, I_CHECK },
};

// renders the life screen (k = 0) or the menu (k = 1) and shrinks it into thumbs[k]
void renderThumb(int k) {
  if (k == 0) { screen = S_LIFE; paintLife(); }
  else { int keep = menuCur; menuCur = M_BACK; paintMenu(); menuCur = keep; }
  uint16_t *dst = thumbs[k];
  for (int ty = 0; ty < THUMB_D; ty++)
    for (int tx = 0; tx < THUMB_D; tx++) {
      int sx = tx * W / THUMB_D, sy = ty * H / THUMB_D, r = 0, g = 0, b = 0;
      for (int yy = sy; yy < sy + 3; yy++)
        for (int xx = sx; xx < sx + 3; xx++) {
          uint16_t v = swap16(fbPix[min(yy, H - 1) * W + min(xx, W - 1)]);
          r += v >> 11; g += (v >> 5) & 0x3F; b += v & 0x1F;
        }
      dst[ty * THUMB_D + tx] = swap16((uint16_t)((r / 9) << 11 | (g / 9) << 5 | (b / 9)));
    }
  screen = S_LAYOUT;
}

void paintLayoutPicker() {
  showScreen(S_LAYOUT);
  fb.setTextDatum(MC_DATUM);
  fb.setTextPadding(0);
  const char *titles[2] = { "Tela", "Menu" };
  const char *names[2] = { LIFE_LAYOUT_NAMES[lifeLayout], MENU_LAYOUT_NAMES[menuLayout] };
  const int counts[2] = { LIFE_LAYOUTS, MENU_LAYOUTS }, cur[2] = { lifeLayout, menuLayout };
  for (int k = 0; k < 2; k++) {
    int cx = THUMB_X[k];
    fb.fillSmoothCircle(cx, THUMB_Y, THUMB_R + 2, btnBorder(), TFT_BLACK);
    for (int y = -THUMB_R; y <= THUMB_R; y++)
      for (int x = -THUMB_R; x <= THUMB_R; x++)
        if (x * x + y * y <= THUMB_R * THUMB_R)
          fbPix[(THUMB_Y + y) * W + cx + x] = thumbs[k][(y + THUMB_R) * THUMB_D + x + THUMB_R];
    fb.setTextColor(GREY);
    fb.drawString(titles[k], cx, 38, 2);
    fb.setTextColor(TFT_WHITE);
    fb.drawString(names[k], cx, 157, 2);
    for (int i = 0; i < counts[k]; i++) {
      int x = cx + (int)lroundf((i - (counts[k] - 1) / 2.0f) * 9);
      if (i == cur[k]) fb.fillSmoothCircle(x, 174, 3, TFT_WHITE, TFT_BLACK);
      else fb.fillSmoothCircle(x, 174, 2, GREY, TFT_BLACK);
    }
  }
  Btn bg = LAYOUT_BTNS[LY_BG];
  bg.label = menuBg ? "Fundo" : "Sem fundo";
  drawButton(bg, menuBg ? TFT_GREEN : GREY);
  drawButton(LAYOUT_BTNS[LY_OK], TFT_GREEN);
  markDirty(0, 0, W, H);
}

void drawLayoutPicker() {
  renderThumb(0);
  renderThumb(1);
  paintLayoutPicker();
  flush();
}

void onLayoutTap(int x, int y) {
  int i = buttonAt(LAYOUT_BTNS, LY_COUNT, x, y);
  if (i == LY_LIFE) { lifeLayout = (lifeLayout + 1) % LIFE_LAYOUTS; renderThumb(0); }
  else if (i == LY_MENU) { menuLayout = (menuLayout + 1) % MENU_LAYOUTS; renderThumb(1); }
  else if (i == LY_BG) { menuBg = !menuBg; renderThumb(1); }
  else if (i == LY_OK) {
    DBG("layout %d menu %d bg %d saved", lifeLayout, menuLayout, menuBg);
    requestSave();
    closeMenu();
    return;
  } else return;
  paintLayoutPicker();
  flush();
}

void drawDicePicker() {
  showScreen(S_DICE_PICK);
  for (int i = 0; i <= DICE_COUNT; i++) drawButton(DICE_BTNS[i], btnBorder());
  markDirty(0, 0, W, H);
  flush();
}

// round thumbnail of a custom slot's background, centered on (cx, cy)
void drawSlotThumb(int slot, int cx, int cy, int r) {
  const CustomTheme *h = ctHeader(slot);
  const uint16_t *pal = (const uint16_t *)((const uint8_t *)h + 64);
  const uint8_t *px = ctPixels(slot);
  for (int y = -r; y <= r; y++)
    for (int x = -r; x <= r; x++) {
      if (x * x + y * y > r * r) continue;
      int sx = 120 + x * 120 / r, sy = 120 + y * 120 / r;
      fb.drawPixel(cx + x, cy + y, pal[px[constrain(sy, 0, 239) * W + constrain(sx, 0, 239)]]);
    }
}

void drawThemePicker() {
  showScreen(S_THEME);
  fb.setTextDatum(MC_DATUM);
  fb.setTextPadding(0);
  for (int i = 0; i < THEME_COUNT; i++) {
    const Btn &b = THEME_BTNS[i];
    const Theme &t = THEMES[i];
    uint16_t fill = (i == 0) ? BTN_FILL : t.accent;
    fb.fillRoundRect(b.x, b.y, b.w, b.h, 10, fill);
    fb.drawRoundRect(b.x, b.y, b.w, b.h, 10, i == theme ? TFT_WHITE : t.ring);
    if (i == theme) fb.drawRoundRect(b.x + 1, b.y + 1, b.w - 2, b.h - 2, 9, TFT_WHITE);
    fb.setTextColor(i == 0 ? TFT_WHITE : TFT_BLACK, fill);
    fb.drawString(THEME_LABELS[i], b.x + b.w / 2, b.y + b.h / 2 + 1, 4);
  }
  for (int k = 0; k < CT_SLOTS; k++) {
    const Btn &b = THEME_BTNS[THEME_COUNT + k];
    bool sel = theme == THEME_COUNT + k;
    fb.fillRoundRect(b.x, b.y, b.w, b.h, 10, BTN_FILL);
    if (ctValid[k]) {
      drawSlotThumb(k, b.x + b.w / 2, b.y + b.h / 2, b.h / 2 - 4);
      fb.drawRoundRect(b.x, b.y, b.w, b.h, 10, sel ? TFT_WHITE : ctHeader(k)->acc);
      if (sel) fb.drawRoundRect(b.x + 1, b.y + 1, b.w - 2, b.h - 2, 9, TFT_WHITE);
    } else {
      fb.drawRoundRect(b.x, b.y, b.w, b.h, 10, 0x39E7);
      fb.setTextColor(GREY, BTN_FILL);
      fb.drawString(String(k + 1), b.x + b.w / 2, b.y + b.h / 2 + 1, 4);   // empty slot
    }
  }
  drawButton(THEME_BTNS[THEME_BT], bleAdvertising || bleConnected ? 0x3CBF : btnBorder());
  drawButton(THEME_BTNS[THEME_LAYOUT], btnBorder());
  drawButton(THEME_BTNS[THEME_BACK], btnBorder());
  markDirty(0, 0, W, H);
  flush();
}

void drawFontSample() {
  fb.fillRect(CX - LIFE_W / 2, 26, LIFE_W, FONT_SAMPLE_Y + LIFE_H / 2 - 26, TFT_BLACK);
  drawRing();                           // the clear above cuts into the ring's top
  // position dots
  const int gap = 12, x0 = CX - (FONT_COUNT - 1) * gap / 2;
  for (int i = 0; i < FONT_COUNT; i++) {
    if (i == fontIdx) fb.fillSmoothCircle(x0 + i * gap, 36, 4, TFT_WHITE, TFT_BLACK);
    else              fb.fillSmoothCircle(x0 + i * gap, 36, 2, GREY, TFT_BLACK);
  }
  drawNumber(previewNum, FONT_SAMPLE_Y, lifeColor(previewNum));
  markDirty(CX - LIFE_W / 2, 26, LIFE_W, FONT_SAMPLE_Y + LIFE_H / 2 - 26);
}

void drawFontPicker() {
  showScreen(S_FONT);
  drawRing();
  drawButton(FONT_BTNS[F_PREV], btnBorder());
  drawButton(FONT_BTNS[F_OK], TFT_GREEN);
  drawButton(FONT_BTNS[F_NEXT], btnBorder());
  drawFontSample();
  markDirty(0, 0, W, H);
  flush();
}

void onFontTap(int x, int y) {
  int i = buttonAt(FONT_BTNS, F_COUNT, x, y);
  if (i == F_PREV || i == F_NEXT) {
    fontIdx = (fontIdx + (i == F_NEXT ? 1 : FONT_COUNT - 1)) % FONT_COUNT;
    DBG("font %d", fontIdx);
    drawFontSample();
    flush();
  } else if (i == F_OK) {
    DBG("font %d saved", fontIdx);
    requestSave();
    closeMenu();
  }
}

// Big result in the same font as the life total.
const int DICE_NUM_Y = CY + 8, DICE_NUM_W = 200, DICE_NUM_H = 110;

void drawDiceNumber(int v, uint16_t color) {
  fb.fillRect(CX - DICE_NUM_W / 2, DICE_NUM_Y - DICE_NUM_H / 2, DICE_NUM_W, DICE_NUM_H, TFT_BLACK);
  drawBig(*FONTS[fontIdx].xl, String(v), CX, DICE_NUM_Y, color);
  markDirty(CX - DICE_NUM_W / 2, DICE_NUM_Y - DICE_NUM_H / 2, DICE_NUM_W, DICE_NUM_H);
  flush();
}

void rollDice(int sides) {
  showScreen(S_DICE_RESULT);
  fb.setTextDatum(MC_DATUM);
  fb.setTextPadding(0);
  fb.setTextColor(GREY, TFT_BLACK);
  fb.drawString("d" + String(sides), CX, 40, 4);
  drawIcon(I_BACK, CX, 205, GREY, TFT_BLACK);   // any tap goes back
  markDirty(0, 0, W, H);
  flush();

  // short shuffle animation, then the real roll
  for (int i = 0; i < 8; i++) {
    drawDiceNumber(random(1, sides + 1), GREY);
    delay(50);
  }
  int v = random(1, sides + 1);
  uint16_t color = (v == sides) ? TFT_GREEN : (v == 1 ? TFT_RED : TFT_WHITE);
  drawDiceNumber(v, color);
  DBG("dice d%d -> %d", sides, v);
}

// Backlight PWM on D6 (active high). Low-battery mode dims it, except on the
// brightness screen, which shows the chosen value while it is being set.
void applyBrightness() {
  int b = (lowBattery && screen != S_BRIGHT) ? LOW_BAT_BRIGHT : brightness;
  analogWrite(BACKLIGHT, b * 255 / 100);
}

// Brightness screen: works like the life screen. "-" / "+" tap = 1%, hold = 10%
// repeating; dragging around the rim = 1% per BRIGHT_STEP_DEG. The "apagar tela"
// button cycles the auto-off time. OK saves and goes back.
enum { B_MINUS, B_PLUS, B_SLEEP, B_OK, B_COUNT };
const Btn BRIGHT_BTNS[B_COUNT] = {
  { 34,  62, 52, 50, "-" },
  { 154, 62, 52, 50, "+" },
  { 65, 142, 110, 36, nullptr },        // label: SLEEP_LABELS[sleepIdx]
  { 80, 186, 80, 32, nullptr, I_CHECK },
};

void drawBrightnessValue() {
  fb.fillRect(CX - 31, 72, 62, 30, TFT_BLACK);
  fb.setTextDatum(MC_DATUM);
  fb.setTextPadding(0);
  fb.setTextColor(TFT_WHITE, TFT_BLACK);
  fb.drawString(String(brightness) + "%", CX, 88, 4);
  markDirty(CX - 31, 72, 62, 30);
}

void drawSleepButton() {
  Btn b = BRIGHT_BTNS[B_SLEEP];
  if (SLEEP_SECS[sleepIdx] == 0) b.icon = I_INF;     // never
  else b.label = SLEEP_LABELS[sleepIdx];
  drawButton(b, btnBorder());
  markDirty(b.x, b.y, b.w, b.h);
}

void drawBrightness() {
  showScreen(S_BRIGHT);
  drawRing();
  drawIcon(I_SUN, CX, 40, GREY, TFT_BLACK);     // brightness
  drawIcon(I_MOON, CX, 125, GREY, TFT_BLACK);   // screen auto-off (button below)
  drawButton(BRIGHT_BTNS[B_MINUS], btnBorder());
  drawButton(BRIGHT_BTNS[B_PLUS], btnBorder());
  drawButton(BRIGHT_BTNS[B_OK], TFT_GREEN);
  drawSleepButton();
  drawBrightnessValue();
  markDirty(0, 0, W, H);
  flush();
  applyBrightness();                    // low-battery mode: show the real setting here
}

void changeBrightness(int d) {
  int b = constrain(brightness + d, BRIGHT_MIN, 100);
  if (b == brightness) return;
  brightness = b;
  applyBrightness();
  brightDirty = true;
}

void onBrightnessTap(int x, int y) {
  int i = buttonAt(BRIGHT_BTNS, B_COUNT, x, y);
  if (i == B_SLEEP) {
    sleepIdx = (sleepIdx + 1) % SLEEP_OPTIONS;
    DBG("auto-off %d s", SLEEP_SECS[sleepIdx]);
    drawSleepButton();
    flush();
  } else if (i == B_OK) {
    DBG("brightness %d, auto-off %d s saved", brightness, SLEEP_SECS[sleepIdx]);
    requestSave();
    closeMenu();
  }
}

// ---- screen auto-off ----
// GC9A01: 0x28 display off, 0x10 sleep in / 0x11 sleep out, 0x29 display on.
// The panel keeps its RAM while asleep; we still repaint everything on wake.
void screenSleep() {
  DBG("screen off");
  asleep = true;
  wantMarkerX = wantMarkerY = -1;
  tickWant = -1;
  analogWrite(BACKLIGHT, 0);
  tft.writecommand(0x28);
  tft.writecommand(0x10);
}

void screenWake() {
  DBG("screen on");
  asleep = false;
  tft.writecommand(0x11);
  delay(120);                           // sleep-out settle time (datasheet)
  tft.writecommand(0x29);
  markDirty(0, 0, W, H);
  flush();
  applyBrightness();
}

void openMenu() {
  DBG("menu open");
  menuCur = M_BACK;                     // carousel / list start on "back": a stray tap is harmless
  drawMenu();
}

void closeMenu() {
  screen = S_LIFE;
  fullRedraw();
  applyBrightness();                    // leaving the brightness screen / battery re-read
}

void resetGame(int start) {
  startingLife = start;
  life = start;
  pendingDelta = 0;
  histCount = 0;
  requestSave();
}

void onMenuTap(int x, int y) {
  int item;
  if (menuLayout == ML_CAROUSEL) {      // the big circle runs the item, the neighbors move to it
    auto near = [&](int cx, int cy, int r) { int dx = x - cx, dy = y - cy; return dx * dx + dy * dy <= r * r; };
    if (near(CX, 108, 48)) item = menuCur;
    else if (near(40, 108, 28))  { menuCur = (menuCur + M_COUNT - 1) % M_COUNT; drawMenu(); return; }
    else if (near(200, 108, 28)) { menuCur = (menuCur + 1) % M_COUNT; drawMenu(); return; }
    else return;
  } else if (menuLayout == ML_LIST) {   // the middle row runs the item, the others scroll to it
    int o = constrain((int)lroundf((y - CY) / 44.0f), -2, 2);
    if (o != 0) { menuCur = (menuCur + o + M_COUNT) % M_COUNT; drawMenu(); return; }
    item = menuCur;
  } else item = menuHit(x, y);
  DBG("menu tap item=%d", item);
  switch (item) {
    case M_RESET: resetGame(startingLife); break;
    case M_20:    resetGame(20); break;
    case M_40:    resetGame(40); break;
    case M_DICE:  drawDicePicker(); return;
    case M_LIGHT: drawBrightness(); return;
    case M_THEME: drawThemePicker(); return;
    case M_FONT:  previewNum = life; drawFontPicker(); return;
    case M_BACK:  break;
    default:      return;               // tapped outside the buttons: keep the menu open
  }
  closeMenu();
}

void onDicePickTap(int x, int y) {
  int i = buttonAt(DICE_BTNS, DICE_COUNT + 1, x, y);
  DBG("dice pick tap item=%d", i);
  if (i < 0) return;                    // outside the buttons: stay
  if (i == DICE_COUNT) closeMenu();     // Voltar
  else rollDice(DICE_SIDES[i]);
}

void onThemeTap(int x, int y) {
  int i = buttonAt(THEME_BTNS, THEME_BTN_COUNT, x, y);
  DBG("theme tap item=%d", i);
  if (i < 0) return;
  if (i == THEME_LAYOUT) { drawLayoutPicker(); return; }
  if (i == THEME_BT) { bleOn(); drawBleScreen(); return; }
  if (i >= THEME_COUNT && i < THEME_COUNT + CT_SLOTS && !ctValid[i - THEME_COUNT]) return;  // empty slot
  if (i < THEME_COUNT + CT_SLOTS && i != theme) { theme = i; themeChanged(); applyThemeFont(); requestSave(); }
  closeMenu();
}

void onScreenTap(int x, int y) {
  switch (screen) {
    case S_MENU:        onMenuTap(x, y); break;
    case S_DICE_PICK:   onDicePickTap(x, y); break;
    case S_DICE_RESULT: closeMenu(); break;   // any tap leaves the result
    case S_BRIGHT:      onBrightnessTap(x, y); break;
    case S_THEME:       onThemeTap(x, y); break;
    case S_FONT:        onFontTap(x, y); break;
    case S_LAYOUT:      onLayoutTap(x, y); break;
    case S_BLE:         onBleTap(x, y); break;
    default: break;
  }
}

// Seed random() from the nRF52 hardware RNG (called before the SoftDevice starts).
void seedRandom() {
  uint32_t seed = 0;
  NRF_RNG->CONFIG = RNG_CONFIG_DERCEN_Enabled << RNG_CONFIG_DERCEN_Pos;  // bias correction
  NRF_RNG->TASKS_START = 1;
  for (int i = 0; i < 4; i++) {
    NRF_RNG->EVENTS_VALRDY = 0;
    while (!NRF_RNG->EVENTS_VALRDY) {}
    seed = (seed << 8) | NRF_RNG->VALUE;
  }
  NRF_RNG->TASKS_STOP = 1;
  randomSeed(seed);
}

// ================= Logic =================
void changeLife(int d) {
  int nv = constrain(life + d, -999, 999);
  if (nv == life) return;
  pendingDelta += nv - life;
  life = nv;
  lastChangeMs = millis();
  lifeDirty = deltaDirty = true;
  requestSave();
}

// +/- from taps, holds and the rim: changes whatever the current screen controls
void nudge(int d) {
  if (screen == S_BRIGHT) changeBrightness(d);
  else if (screen == S_FONT) {
    previewNum = constrain(previewNum + d, -999, 999);
    fontDirty = true;
  }
  else if (screen == S_MENU) {          // carousel / list: rim scrolls
    menuCur = (menuCur + (d > 0 ? 1 : M_COUNT - 1)) % M_COUNT;
    menuDirty = true;
  }
  else changeLife(d);
}

float angleOf(int x, int y) {
  return atan2f((float)(y - CY), (float)(x - CX)) * 180.0f / PI; // clockwise positive
}

int distOf(int x, int y) {
  int ddx = x - CX, ddy = y - CY;
  return (int)sqrtf((float)(ddx * ddx + ddy * ddy));
}

Zone zoneOf(int x, int y) {
  int d = distOf(x, y);
  if (screen == S_BRIGHT) {
    int b = buttonAt(BRIGHT_BTNS, B_COUNT, x, y);
    if (b == B_MINUS) return Z_MINUS;
    if (b == B_PLUS)  return Z_PLUS;
    if (b < 0 && d >= RIM_INNER_R) return Z_RIM;
    return Z_MENU;                      // OK (or empty space): handled on touch end
  }
  if (screen == S_FONT) {                // buttons on touch end; elsewhere like the life screen
    if (buttonAt(FONT_BTNS, F_COUNT, x, y) >= 0) return Z_MENU;
    if (d >= RIM_INNER_R) return Z_RIM;
    return (x >= CX) ? Z_PLUS : Z_MINUS;
  }
  if (screen == S_MENU && (menuLayout == ML_CAROUSEL || menuLayout == ML_LIST) && d >= RIM_INNER_R)
    return Z_RIM;                       // a rim touch that doesn't move is still a tap
  if (screen != S_LIFE) return Z_MENU;
  if (d >= RIM_INNER_R) return Z_RIM;
  if (d < CENTER_R)     return Z_CENTER;
  return (x >= CX) ? Z_PLUS : Z_MINUS;
}

void onTouchStart(int x, int y) {
  lastActivityMs = millis();
  if (asleep) {                         // this touch only wakes the screen
    screenWake();
    touching = true;
    zone = Z_NONE;
    DBG("wake touch ignored");
    return;
  }
  touching = true;
  touchX = x; touchY = y;
  touchStart = millis();
  lastHoldMs = touchStart;
  holdFired = false;
  angleAccum = 0;
  rimMoved = false;
  zone = zoneOf(x, y);
  lastAngle = angleOf(x, y);
  DBG("touch start x=%d y=%d dist=%d zone=%d", x, y, distOf(x, y), zone);
}

void onTouchMove(int x, int y) {
  if (zone != Z_RIM) return;
  float a = angleOf(x, y);
  float d = a - lastAngle;
  if (d > 180)  d -= 360;
  if (d < -180) d += 360;
  lastAngle = a;
  if (fabsf(d) > MAX_JUMP_DEG) {      // glitch or finger lifted/replaced: re-anchor, don't count
    DBG("jump ignored %.0f deg", d);
    return;
  }
  if (INVERT_DIRECTION) d = -d;
  angleAccum += d;

  const float step = (screen == S_BRIGHT) ? BRIGHT_STEP_DEG : (screen == S_MENU ? MENU_STEP_DEG : STEP_DEGREES);
  while (angleAccum >= step)  { nudge(+1); angleAccum -= step; rimMoved = true; }
  while (angleAccum <= -step) { nudge(-1); angleAccum += step; rimMoved = true; }

  if (screen != S_LIFE) return;         // the dot is only drawn on the life screen
  if (lifeLayout == L_TICKS) {          // ticks light up instead of the dot
    tickWant = fmodf(a + 90 + 360, 360);
    return;
  }

  // marker dot snapped onto the ring
  float rad = a * PI / 180.0f;
  wantMarkerX = CX + (int)(98 * cosf(rad));
  wantMarkerY = CY + (int)(98 * sinf(rad));
}

// Called every loop while touching, even with no new report (finger held still).
void checkHold() {
  if (!touching || (zone != Z_PLUS && zone != Z_MINUS)) return;
  if (millis() - lastHoldMs >= HOLD_MS) {
    lastHoldMs = millis();
    holdFired = true;
    nudge(zone == Z_PLUS ? +10 : -10);
  }
}

void onTouchEnd() {
  unsigned long held = millis() - touchStart;
  DBG("touch end zone=%d held=%lu life=%d", zone, held, life);
  touching = false;
  wantMarkerX = wantMarkerY = -1;
  tickWant = -1;
  switch (zone) {
    case Z_RIM:    if (screen == S_MENU && !rimMoved) onScreenTap(touchX, touchY); break;
    case Z_PLUS:   if (!holdFired) nudge(+1); break;
    case Z_MINUS:  if (!holdFired) nudge(-1); break;
    case Z_CENTER: if (held < MENU_TAP_MAX_MS) openMenu(); break;
    case Z_MENU:   onScreenTap(touchX, touchY); break;
    default: break;
  }
  zone = Z_NONE;
}

// ================= Arduino =================
// ================= BLE: themes from the web page =================
// One GATT service (UUIDs 4d5447xx-6c69-6665-2d63-6f756e746572, "MTG.life-counter"):
//   CTRL (write + notify): commands, answered by a notify starting with the same byte
//     01                    INFO   -> 01 ver slots validMask theme builtinCount enabled mtu
//     02 slot size(u32)     BEGIN  -> 02 status        (erases the slot, then accepts DATA)
//     04                    END    -> 04 status        (CRC check; 0 = slot valid)
//     05 theme              SELECT -> 05 status        (0..5 built in, 6.. custom slots)
//     06 bytes...           DATA via CTRL, no reply (v2). Bluefy on iOS never delivers
//                           writes to DATA, with or without response, but CTRL works.
//   DATA (write without response): the record bytes, in order. Every flash page
//     written is acknowledged with 03 bytesWritten(u32); the page keeps at most
//     RX_SIZE/2 bytes in flight past the last ack, so the buffer never overflows.
//   Errors: 7F code (1 = buffer overflow, 2 = unexpected data).
// Callbacks run in the BLE task: they only queue; loop() does the work.
const uint8_t PROTO_VERSION = 2;      // 2: DATA bytes can also come through CTRL (06 ...)
const uint8_t UUID_SVC[16]  = { 0x72,0x65,0x74,0x6e,0x75,0x6f,0x63,0x2d,0x65,0x66,0x69,0x6c,0x00,0x47,0x54,0x4d };
const uint8_t UUID_CTRL[16] = { 0x72,0x65,0x74,0x6e,0x75,0x6f,0x63,0x2d,0x65,0x66,0x69,0x6c,0x01,0x47,0x54,0x4d };
const uint8_t UUID_DATA[16] = { 0x72,0x65,0x74,0x6e,0x75,0x6f,0x63,0x2d,0x65,0x66,0x69,0x6c,0x02,0x47,0x54,0x4d };
BLEService        mtgSvc(UUID_SVC);
BLECharacteristic ctrlChr(UUID_CTRL);
BLECharacteristic dataChr(UUID_DATA);

const uint32_t RX_SIZE = 16384;
uint8_t rxBuf[RX_SIZE];
volatile uint32_t rxHead = 0, rxTail = 0;
volatile bool rxOverflow = false;
volatile uint8_t cmdBuf[20];
volatile uint8_t cmdLen = 0;

enum { UP_IDLE, UP_RECV } upState = UP_IDLE;
// connection interval in 1.25 ms units: 15 ms while a theme is coming in (the shortest
// iOS accepts, and it must be asked as min = max), 30 ms otherwise to save battery
const uint16_t CONN_FAST = 12, CONN_IDLE = 24;
unsigned long upStartMs = 0;
int      upSlot = 0;
uint32_t upSize = 0, upWritten = 0, upFill = 0;
uint8_t  upPage[PAGE_SIZE] __attribute__((aligned(4)));

uint32_t crc32(const uint8_t *p, uint32_t n) {
  uint32_t c = 0xFFFFFFFF;
  while (n--) {
    c ^= *p++;
    for (int k = 0; k < 8; k++) c = (c >> 1) ^ (0xEDB88320 & (0 - (c & 1)));
  }
  return ~c;
}

bool ctCheck(int slot) {
  const CustomTheme *h = ctHeader(slot);
  return ctEnabled && h->magic == CT_MAGIC && h->len == CT_RECORD &&
         h->crc == crc32((const uint8_t *)h + 12, h->len - 12);
}

extern uint32_t __etext, __data_start__, __data_end__;

void ctInit() {
  uint32_t appEnd = (uint32_t)&__etext + ((uint32_t)&__data_end__ - (uint32_t)&__data_start__);
  ctEnabled = appEnd <= CT_BASE;
  if (!ctEnabled) DBG("firmware ends at 0x%lx, past the theme slots (0x%lx): custom themes off", appEnd, CT_BASE);
  for (int k = 0; k < CT_SLOTS; k++) ctValid[k] = ctCheck(k);
  if (theme >= THEME_COUNT && !ctValid[theme - THEME_COUNT]) theme = 0;
  themeChanged();
  DBG("custom themes: app ends 0x%lx, slots valid %d %d", appEnd, ctValid[0], ctValid[1]);
}

void onDataWrite(uint16_t, BLECharacteristic *, uint8_t *data, uint16_t len);
void onCtrlWrite(uint16_t conn, BLECharacteristic *chr, uint8_t *data, uint16_t len) {
  bleLastMs = millis();
  if (len > 1 && data[0] == 0x06) { onDataWrite(conn, chr, data + 1, len - 1); return; }
  if (cmdLen || len == 0 || len > sizeof(cmdBuf)) return;   // one command at a time
  for (int i = 0; i < len; i++) cmdBuf[i] = data[i];
  cmdLen = len;
}

uint16_t bleConn = 0;                    // handle of the current (only) connection
#if DEBUG
volatile uint32_t rxBytes = 0, rxWrites = 0, rxMinLen = 9999, rxMaxLen = 0;   // diag
#endif
void onDataWrite(uint16_t, BLECharacteristic *, uint8_t *data, uint16_t len) {
  bleLastMs = millis();
#if DEBUG
  rxBytes += len; rxWrites++; if (len < rxMinLen) rxMinLen = len; if (len > rxMaxLen) rxMaxLen = len;
#endif
  for (int i = 0; i < len; i++) {
    uint32_t n = (rxHead + 1) % RX_SIZE;
    if (n == rxTail) { rxOverflow = true; return; }
    rxBuf[rxHead] = data[i];
    rxHead = n;
  }
}

void bleReply(const uint8_t *p, int n) {
  if (Bluefruit.connected()) ctrlChr.notify(p, n);
}
void bleReply2(uint8_t a, uint8_t b) { uint8_t r[2] = { a, b }; bleReply(r, 2); }

// shows the life screen with the (possibly new) theme, waking the panel if needed
void showThemeNow() {
  lastActivityMs = millis();
  if (screen != S_LIFE) screen = S_LIFE;
  fullRedraw();
  if (asleep) screenWake();
  else applyBrightness();
}

void bleCommand(const uint8_t *c, int n) {
  switch (c[0]) {
    case 0x01: {
      uint8_t mask = 0;
      for (int k = 0; k < CT_SLOTS; k++) if (ctValid[k]) mask |= 1 << k;
      // byte 7 = current ATT MTU (older pages ignore it; they must size DATA writes to MTU-3)
      BLEConnection *conn = Bluefruit.Connection(bleConn);
      uint16_t mtu = conn ? conn->getMtu() : 23;
      uint8_t r[8] = { 0x01, PROTO_VERSION, CT_SLOTS, mask, (uint8_t)theme, (uint8_t)THEME_COUNT, ctEnabled,
                       (uint8_t)(mtu > 255 ? 255 : mtu) };
      bleReply(r, 8);
      DBG("ble info, mtu %d", mtu);
      break;
    }
    case 0x02: {
      if (n < 6) { bleReply2(0x02, 1); break; }
      int slot = c[1];
      uint32_t size = c[2] | (c[3] << 8) | (c[4] << 16) | ((uint32_t)c[5] << 24);
      if (!ctEnabled) { bleReply2(0x02, 2); break; }
      if (slot >= CT_SLOTS || size != CT_RECORD) { bleReply2(0x02, 1); break; }
      if (theme == THEME_COUNT + slot) {  // replacing the theme on screen: fall back meanwhile
        theme = 0;
        if (screen == S_LIFE && !asleep) { fullRedraw(); }
      }
      ctValid[slot] = false;
      upState = UP_IDLE;
      // pages are erased one by one as their data arrives (bleTask), so the ~2.7 s of
      // erasing overlaps the transfer; an upload cut short before the first page leaves
      // the old record intact (its CRC still matches on the next boot)
      DBG("ble begin slot %d size %lu, mtu %d", slot, size, Bluefruit.Connection(bleConn) ? Bluefruit.Connection(bleConn)->getMtu() : -1);
      upSlot = slot; upSize = size; upWritten = 0; upFill = 0;
      rxTail = rxHead; rxOverflow = false;
      upState = UP_RECV;
      upStartMs = millis();
      if (BLEConnection *bc = Bluefruit.Connection(bleConn)) bc->requestConnectionParameter(CONN_FAST);
      bleReply2(0x02, 0);
      break;
    }
    case 0x04: {
      bool ok = upState == UP_RECV && upWritten == upSize && ctCheck(upSlot);
      upState = UP_IDLE;
      ctValid[upSlot] = ok;
      BLEConnection *bc = Bluefruit.Connection(bleConn);
      DBG("ble end slot %d: %s, %lu ms since begin, interval %d", upSlot, ok ? "valid" : "INVALID",
          millis() - upStartMs, bc ? bc->getConnectionInterval() : -1);
      if (bc) bc->requestConnectionParameter(CONN_IDLE);
      bleReply2(0x04, ok ? 0 : 1);
      if (screen == S_THEME) drawThemePicker();
      break;
    }
    case 0x05: {
      int t = n > 1 ? c[1] : -1;
      bool ok = (t >= 0 && t < THEME_COUNT) || (t >= THEME_COUNT && t < THEME_COUNT + CT_SLOTS && ctValid[t - THEME_COUNT]);
      if (ok) {
        theme = t;
        themeChanged();
        applyThemeFont();
        requestSave();
        showThemeNow();
        DBG("ble theme %d", theme);
      }
      bleReply2(0x05, ok ? 0 : 1);
      break;
    }
    default:
      bleReply2(0x7F, 3);
  }
}

void bleTask() {
  if (cmdLen) {
    uint8_t c[20];
    int n = cmdLen;
    for (int i = 0; i < n; i++) c[i] = cmdBuf[i];
    cmdLen = 0;
    bleCommand(c, n);
  }
  if (rxOverflow) {
    rxOverflow = false;
    rxTail = rxHead;
    upState = UP_IDLE;
    bleReply2(0x7F, 1);
    DBG("ble rx overflow");
  }
  if (upState != UP_RECV) { rxTail = rxHead; return; }   // stray data is dropped
  while (rxTail != rxHead) {
    if (upWritten + upFill >= upSize) { upState = UP_IDLE; bleReply2(0x7F, 2); return; }
    upPage[upFill++] = rxBuf[rxTail];
    rxTail = (rxTail + 1) % RX_SIZE;
    if (upFill == PAGE_SIZE || upWritten + upFill == upSize) {
      uint32_t words = (upFill + 3) / 4;
      for (uint32_t i = upFill; i < words * 4; i++) upPage[i] = 0xFF;
      flashErasePage(CT_BASE + upSlot * CT_SLOT_BYTES + upWritten);   // upWritten is page aligned here
      flashWriteWords(CT_BASE + upSlot * CT_SLOT_BYTES + upWritten, (const uint32_t *)upPage, words);
      upWritten += upFill;
      upFill = 0;
      uint8_t r[5] = { 0x03, (uint8_t)upWritten, (uint8_t)(upWritten >> 8), (uint8_t)(upWritten >> 16), (uint8_t)(upWritten >> 24) };
      bleReply(r, 5);
      return;                             // one page per loop keeps the touch responsive
    }
  }
}

// ---- Bluetooth on / off ----
void bleOn() {
  bleOnMs = millis();
  if (bleConnected || bleAdvertising) return;
  Bluefruit.Advertising.setInterval(160, 1600);  // 100 ms for the first 30 s, then 1 s
  Bluefruit.Advertising.setFastTimeout(30);
  Bluefruit.Advertising.start(0);
  bleAdvertising = true;
  DBG("ble advertising on");
}

void bleOff() {
  if (bleAdvertising) Bluefruit.Advertising.stop();
  bleAdvertising = false;
  if (bleConnected) Bluefruit.disconnect(bleConn);
  DBG("ble off");
}

// timeouts; called every loop
void bleWatch() {
  if (bleAdvertising && !bleConnected && millis() - bleOnMs > BLE_ADV_S * 1000UL) {
    DBG("ble advertising timed out");
    bleOff();
    if (screen == S_BLE) closeMenu();
  }
  if (bleConnected && upState == UP_IDLE && millis() - bleLastMs > BLE_IDLE_S * 1000UL) {
    DBG("ble idle, disconnecting");
    bleLastMs = millis();               // don't ask again every loop while it goes
    Bluefruit.disconnect(bleConn);
  }
  if (bleUiDirty && screen == S_BLE && !asleep) { bleUiDirty = false; drawBleScreen(); }
}

// Bluetooth screen: status, a hint for the web page and "Desligar" / back
enum { BT_OFF, BT_BACK, BT_COUNT };
const Btn BLE_BTNS[BT_COUNT] = {
  { 52, 168, 84, 36, "Desligar" }, { 144, 168, 44, 36, nullptr, I_BACK },
};

void drawBleScreen() {
  showScreen(S_BLE);
  bool on = bleConnected || bleAdvertising;
  drawIcon(I_BT, CX, 58, on ? 0x3CBF : GREY, TFT_BLACK, 1.6f);
  fb.setTextDatum(MC_DATUM);
  fb.setTextPadding(0);
  fb.setTextColor(TFT_WHITE);
  fb.drawString(bleConnected ? "Conectado" : (on ? "Esperando..." : "Desligado"), CX, 104, 4);
  fb.setTextColor(GREY);
  if (bleConnected) fb.drawString("Envie o tema pelo site", CX, 136, 2);
  else if (on) {
    fb.drawString("No site, toque em Conectar", CX, 130, 2);
    fb.drawString("e escolha \"MTG Life\"", CX, 148, 2);
  }
  drawButton(BLE_BTNS[BT_OFF], on ? TFT_RED : GREY);
  drawButton(BLE_BTNS[BT_BACK], btnBorder());
  markDirty(0, 0, W, H);
  flush();
}

void onBleTap(int x, int y) {
  int i = buttonAt(BLE_BTNS, BT_COUNT, x, y);
  if (i == BT_OFF) { bleOff(); closeMenu(); }
  else if (i == BT_BACK) closeMenu();   // a connection keeps going; advertising times out by itself
}

void onBleConnect(uint16_t conn) {
  bleConn = conn;
  bleConnected = true;
  bleAdvertising = false;               // the stack stops advertising once connected
  bleLastMs = millis();
  bleUiDirty = true;
#if DEBUG
  rxBytes = rxWrites = rxMaxLen = 0; rxMinLen = 9999;
#endif
  BLEConnection *c = Bluefruit.Connection(conn);
  DBG("ble connected, mtu %d, interval %d", c ? c->getMtu() : -1, c ? c->getConnectionInterval() : -1);
  if (c) c->requestPHY(BLE_GAP_PHY_2MBPS);   // falls back to 1M if the central can't
}
void onBleDisconnect(uint16_t conn, uint8_t reason) {
  bleConnected = false;
  bleUiDirty = true;
  DBG("ble disconnected, reason 0x%02x; rx %lu bytes in %lu writes (len %lu..%lu)", reason, rxBytes, rxWrites, rxMinLen, rxMaxLen);
  upState = UP_IDLE;
}

void bleBegin() {
  Bluefruit.autoConnLed(false);         // no blinking blue LED
  Bluefruit.configPrphBandwidth(BANDWIDTH_MAX);   // MTU 247, bigger queues
  Bluefruit.begin();
  Bluefruit.setTxPower(4);              // dBm; the display sits over the antenna
  Bluefruit.setName("MTG Life");
  Bluefruit.Periph.setConnectCallback(onBleConnect);
  Bluefruit.Periph.setDisconnectCallback(onBleDisconnect);

  mtgSvc.begin();
  ctrlChr.setProperties(CHR_PROPS_WRITE | CHR_PROPS_NOTIFY);
  ctrlChr.setPermission(SECMODE_OPEN, SECMODE_OPEN);
  ctrlChr.setMaxLen(244);               // commands are short; 06 + data fills an MTU-247 write
  ctrlChr.setWriteCallback(onCtrlWrite);
  ctrlChr.begin();
  dataChr.setProperties(CHR_PROPS_WRITE | CHR_PROPS_WRITE_WO_RESP);
  dataChr.setPermission(SECMODE_NO_ACCESS, SECMODE_OPEN);
  dataChr.setMaxLen(244);
  dataChr.setWriteCallback(onDataWrite);
  dataChr.begin();

  Bluefruit.Advertising.addFlags(BLE_GAP_ADV_FLAGS_LE_ONLY_GENERAL_DISC_MODE);
  Bluefruit.Advertising.addService(mtgSvc);
  Bluefruit.ScanResponse.addName();
  Bluefruit.Advertising.restartOnDisconnect(false);   // off until "Conectar" on the device
}

void setup() {
#if DEBUG
  Serial.begin(115200);
#endif
  pinMode(TOUCH_INT, INPUT_PULLUP);
  pinMode(BACKLIGHT, OUTPUT);
  digitalWrite(BACKLIGHT, LOW);         // dark until the first real frame is on the panel
  Wire.begin();

  loadState();

  tft.init();
  tft.setRotation(0);

  fb.setColorDepth(16);
  fbPix = (uint16_t *)fb.createSprite(W, H);
  if (!fbPix) {
    digitalWrite(BACKLIGHT, HIGH);
    tft.fillScreen(TFT_BLACK);
    tft.setTextColor(TFT_RED, TFT_BLACK);
    tft.drawString("no RAM for framebuffer", 20, 110, 2);
    while (true) delay(1000);
  }

  seedRandom();                         // before BLE: the SoftDevice then owns the RNG
  bleBegin();
  ctInit();

  unsigned long t1 = micros();
  fullRedraw();
  applyBrightness();                    // light up only once the first frame is on the panel
  unsigned long frameUs = micros() - t1;

#if DEBUG
  // On USB, give the serial monitor up to 3 s to attach (the life screen is already up).
  // On battery there is no host, so don't wait at all.
  if (usbPowered()) {
    unsigned long t0 = millis();
    while (!Serial && millis() - t0 < 3000) delay(10);
  }
#endif
#if DEBUG
  // bootloader identity: its version string lives in the bootloader area (0xF4000..)
  for (uint32_t addr = 0xF4000; addr < 0x100000 - 32; addr++) {
    const char *p = (const char *)addr;
    if (memcmp(p, "UF2 Bootloader", 14) == 0 || memcmp(p, "Bootloader v", 12) == 0) {
      char buf[96];
      int n = 0;
      while (n < 95 && p[n] >= 0x20 && p[n] < 0x7F) { buf[n] = p[n]; n++; }
      buf[n] = 0;
      DBG("bootloader @0x%lx: %s", addr, buf);
      break;
    }
  }
#endif
  lastActivityMs = millis();
  DBG("MTG Life Counter v" FW_VERSION " boot (life=%d theme=%d font=%d start=%d bright=%d sleep=%ds), first frame in %lu us", life, theme, fontIdx, startingLife, brightness, SLEEP_SECS[sleepIdx], frameUs);
}

#if DEBUG
// Test commands over the serial port (one per line), so screens can be exercised
// without touching the panel:  font N | life N | menu | dice N | home
bool serialUpload = false;              // "ctup N": the next CT_RECORD bytes are a theme

void serialCommands() {
  static char line[32];
  static int n = 0;
  if (serialUpload) {                   // binary mode: feed the BLE upload path
    while (Serial.available() && (rxHead + 1) % RX_SIZE != rxTail) {
      rxBuf[rxHead] = Serial.read();
      rxHead = (rxHead + 1) % RX_SIZE;
    }
    if (upState != UP_RECV || upWritten == upSize) {
      serialUpload = false;
      if (upState == UP_RECV) {
        uint8_t e = 0x04;
        bleCommand(&e, 1);
        uint8_t sel[2] = { 0x05, (uint8_t)(THEME_COUNT + upSlot) };
        bleCommand(sel, 2);
      }
    }
    return;
  }
  while (Serial.available()) {
    char c = Serial.read();
    if (c != '\n' && c != '\r') { if (n < 31) line[n++] = c; continue; }
    if (n == 0) continue;
    line[n] = 0;
    n = 0;
    int v = 0;
    unsigned long t0 = micros();
    if (sscanf(line, "font %d", &v) == 1 && v >= 0 && v < FONT_COUNT) { fontIdx = v; drawFontPicker(); }
    else if (sscanf(line, "life %d", &v) == 1) { life = constrain(v, -999, 999); closeMenu(); }
    else if (sscanf(line, "dice %d", &v) == 1 && v > 0) rollDice(v);
    else if (sscanf(line, "ctup %d", &v) == 1) {
      uint8_t c[6] = { 0x02, (uint8_t)v, (uint8_t)CT_RECORD, (uint8_t)(CT_RECORD >> 8), (uint8_t)(CT_RECORD >> 16), 0 };
      bleCommand(c, 6);
      serialUpload = upState == UP_RECV;
    }
    else if (sscanf(line, "bat %d", &v) == 1) {
      batOverride = constrain(v, -1, 100);
      lastBatteryMs = millis() - 31000; // re-read (and apply) on this loop
    }
    else if (sscanf(line, "theme %d", &v) == 1 && v >= 0 && v < THEME_COUNT + CT_SLOTS) { theme = v; themeChanged(); closeMenu(); }
    else if (sscanf(line, "layout %d", &v) == 1) { lifeLayout = v / 10 % LIFE_LAYOUTS; menuLayout = v % 10 % MENU_LAYOUTS; closeMenu(); }
    else if (sscanf(line, "menubg %d", &v) == 1) { menuBg = v; closeMenu(); }
    else if (sscanf(line, "cur %d", &v) == 1) { menuCur = v % M_COUNT; drawMenu(); }
    else if (strcmp(line, "picker") == 0) drawLayoutPicker();
    else if (strcmp(line, "bt") == 0) { bleOn(); drawBleScreen(); }
    else if (strcmp(line, "themes") == 0) drawThemePicker();
    else if (strcmp(line, "shot") == 0) {   // raw framebuffer dump (RGB565, byte-swapped) after "SHOT\n"
      delay(300);
      Serial.write("SHOT\n");
      const uint8_t *q = (const uint8_t *)fbPix;
      size_t left = W * H * 2;
      while (left) { size_t k = Serial.write(q, left > 512 ? 512 : left); q += k; left -= k; if (!k) delay(1); }
      Serial.flush();
      continue;
    }
    else if (strcmp(line, "menu") == 0) openMenu();
    else if (strcmp(line, "home") == 0) closeMenu();
    else { DBG("cmd? '%s'", line); continue; }
    DBG("cmd '%s' done in %lu us", line, micros() - t0);
  }
}
#endif

void loop() {
#if DEBUG
  serialCommands();
  static unsigned long lastBeat = 0;
  if (millis() - lastBeat > 2000) {
    lastBeat = millis();
    DBG("alive t=%lu life=%d touching=%d i2c err=%lu timeouts=%lu rx=%lu/%lu up=%d written=%lu",
        millis(), life, touching, i2cErrors, i2cTimeouts, rxBytes, rxWrites, upState, upWritten);
  }
#endif
  int x, y;
  if (touchReady() && readTouch(x, y)) {
    lastTouchReadMs = millis();
    lastActivityMs = lastTouchReadMs;
    if (!touching) onTouchStart(x, y);
    else           onTouchMove(x, y);
  } else if (touching && millis() - lastTouchReadMs > RELEASE_MS) {
    onTouchEnd();
  }
  checkHold();
  bleTask();
  bleWatch();

  // clear the "+3" indicator 2 s after the last change
  if (pendingDelta != 0 && millis() - lastChangeMs > 2000) {
    pushHistory(pendingDelta);
    pendingDelta = 0;
    deltaDirty = true;
  }

  // refresh battery every 30 s, or right away when USB is plugged / unplugged
  if (millis() - lastBatteryMs > 30000 || (screen == S_LIFE && usbPowered() != shownUsb)) {
    lastBatteryMs = millis();
    bool wasLow = lowBattery;
    drawBattery();
    if (lowBattery != wasLow && !asleep) applyBrightness();
  }

  // auto-off after SLEEP_SECS of no touches (LOW_BAT_SLEEP_S in low-battery mode);
  // menus / dice / brightness get at least MENU_MIN_SLEEP_S so a short setting
  // doesn't blank them mid-choice
  int sleepS = lowBattery ? LOW_BAT_SLEEP_S : SLEEP_SECS[sleepIdx];
  if (sleepS > 0 && screen != S_LIFE) sleepS = max(sleepS, MENU_MIN_SLEEP_S);
  if (screen == S_BLE && (bleAdvertising || bleConnected)) lastActivityMs = millis();
  if (!asleep && !touching && sleepS > 0 &&
      millis() - lastActivityMs > (unsigned long)sleepS * 1000UL) {
    screenSleep();
  }

  // save to flash once things have been quiet for a moment (and not mid-touch)
  if (saveDirty && !touching && millis() - saveDirtySince > SAVE_DELAY_MS) saveState();

  // one frame: draw what changed into the framebuffer, then push the dirty rect
  static unsigned long lastFrame = 0;
  if (!asleep && (screen == S_LIFE || screen == S_BRIGHT || screen == S_FONT || screen == S_MENU) &&
      millis() - lastFrame >= FRAME_MS) {
    lastFrame = millis();
    if (screen == S_LIFE) {
      if (lifeDirty)  { lifeDirty = false;  drawLife(); }
      if (deltaDirty) { deltaDirty = false; drawDelta(); }
      if (lifeLayout == L_TICKS) drawTicks();
    } else if (screen == S_MENU && menuDirty) {
      menuDirty = false;
      paintMenu();
    } else if (screen == S_BRIGHT && brightDirty) {
      brightDirty = false;
      drawBrightnessValue();
    } else if (screen == S_FONT && fontDirty) {
      fontDirty = false;
      drawFontSample();
    }
    drawMarker();
    flush();
  }

  delay(asleep ? 20 : 2);               // asleep: poll the touch less often
}
